; =============================================
; CodeTank GAME6 generic menu + ROM->RAM packer/loader.
;
; The GAME6 "classics" have no relocatable source: they ship as fixed
; Woz-hex images assembled for low-RAM execution ($0280). This menu
; makes them cartridge-bootable: the build script
; (tools/build_codetank_rom.py) parses each shipped .txt into
; {dest, length} segments, appends the raw images to the bank after
; this menu, and generates codetank_game6_table.inc with, per program:
;   - a segment list: .word rom_src, ram_dest, length  (len 0 = end)
;   - a run address
;   - the menu text.
; On a key press the loader walks the program's segment list, copies
; each segment from ROM ($4000+) to RAM with a dumb 16-bit ZP-pointer
; loop (no self-overwrite possible — the source is the ROM window),
; then JMPs the run address. Run-in-place programs (Maze3D, linked at
; $4200 in this bank) use an EMPTY segment list: no copy, straight JMP.
;
; Layout in the lower bank (Codetank_GAME6.rom):
;   $4000-$41FF  Menu + loader + generated table (this file, 512 B)
;   $4200-$5DFF  TMS_Maze3D  (run-in-place, separate bank config)
;   $5E00-...    packed Woz-hex images (OrbitalPool, Stars) — addresses
;                assigned by tools/build_codetank_rom.py
;
; Upper bank ships TMS_SilBench (the 29-test silicon benchmark) — a
; native CodeTank ROM image run-in-place at $4000: flip jumper to
; "Upper" and type 4000R. (Its historical image IS linked at $4000, the
; ROM window itself, so it cannot be RAM-packed — and needs not be.)
;
; Wozmon entry: 4000R after plugging the CodeTank card.
; =============================================

; --- Apple 1 I/O ---
.include "apple1.inc"

; --- Loader zero page (scratch only; live until the JMP, then the
;     launched program owns the machine. $E0+ avoids Wozmon's $24-$2B.)
segp := $E0             ; -> current 6-byte segment-table entry
srcp := $E2             ; ROM source pointer
dstp := $E4             ; RAM destination pointer
cnt  := $E6             ; bytes left in segment (16-bit)
runv := $E8             ; program run address

.code

start:
        LDX #0
@print: LDA menu_text,X
        BEQ @wait_key
        ORA #$80                ; Apple-1 display wants bit 7 set
        JSR ECHO
        INX
        BNE @print

@wait_key:
        LDA KBDCR
        BPL @wait_key           ; KBDCR bit 7 = 1 when a key is ready
        LDA KBD                 ; bit 7 always set on Apple-1 keyboard
        SEC
        SBC #('1' | $80)        ; '1'-> 0, '2'-> 1, ...
        CMP #NPROGS
        BCS @wait_key
        TAX

; --- launch program X: walk its segment list, copy ROM->RAM, run -----
launch:
        LDA prog_seg_lo,X
        STA segp
        LDA prog_seg_hi,X
        STA segp+1
        LDA prog_run_lo,X
        STA runv
        LDA prog_run_hi,X
        STA runv+1

seg_loop:
        LDY #4                  ; entry layout: src(2) dest(2) len(2)
        LDA (segp),Y
        STA cnt
        INY
        LDA (segp),Y
        STA cnt+1
        ORA cnt
        BEQ @run                ; len == 0 → table end, go run
        LDY #0
        LDA (segp),Y
        STA srcp
        INY
        LDA (segp),Y
        STA srcp+1
        INY
        LDA (segp),Y
        STA dstp
        INY
        LDA (segp),Y
        STA dstp+1
        JSR copy_seg
        CLC                     ; segp += 6 → next segment entry
        LDA segp
        ADC #6
        STA segp
        BCC seg_loop
        INC segp+1
        JMP seg_loop

@run:
        JMP (runv)

; --- copy_seg: cnt bytes from (srcp) to (dstp), byte at a time -------
copy_seg:
        LDY #0
@cl:    LDA (srcp),Y
        STA (dstp),Y
        INC srcp
        BNE :+
        INC srcp+1
:       INC dstp
        BNE :+
        INC dstp+1
:       LDA cnt                 ; 16-bit decrement (borrow into high)
        BNE :+
        DEC cnt+1
:       DEC cnt
        LDA cnt
        ORA cnt+1
        BNE @cl
        RTS

; --- Generated by tools/build_codetank_rom.py: NPROGS, prog_seg_lo/hi,
;     prog_run_lo/hi, progN_segs segment lists, menu_text. -------------
.include "codetank_game6_table.inc"
