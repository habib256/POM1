; ============================================================================
; tileset_rogue.inc -- generated by tools/extract_quale_8x8_tiles.py
; ----------------------------------------------------------------------------
; 8x8 pattern table for TMS9918 Mode 1.
;   chars  0..31  -- tile graphics sliced from Quale's SCROLL-O-SPRITES
;                    (16x16 sprites_*.asm, one chosen 8x8 quadrant each)
;   ASCII range    -- font glyphs from Quale's font_quale.asm at the
;                    matching ASCII char IDs ('A'=65, '0'=48, etc.) so
;                    `.byte "ROGUE"` in ca65 streams the right VRAM bytes.
;
; DO NOT EDIT BY HAND. Re-run the script if the palette changes.
; ============================================================================

.export tileset_rogue, tileset_color_table

; --- Tile base char IDs (use as `LDA #TILE_WALL`) ----------------------
; Each tile occupies 4 consecutive chars: base+0=TL, +1=TR, +2=BL, +3=BR.
TILE_EMPTY          = 0
TILE_WALL           = 4
TILE_STAIRS_DOWN    = 8
TILE_DOOR           = 12
TILE_STAIRS_UP      = 16
TILE_TRAP_PIT       = 20
TILE_GOLD           = 24
TILE_POTION         = 28

; --- Pattern table (256 * 8 = 2048 B), upload to VRAM $0000 -------------
tileset_rogue:
        .byte $00, $00, $00, $00, $00, $00, $00, $00    ; char   0  empty.TL (blank)
        .byte $00, $00, $00, $00, $00, $00, $00, $00    ; char   1  empty.TR (blank)
        .byte $00, $00, $00, $00, $00, $00, $00, $00    ; char   2  empty.BL (blank)
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        .byte $00, $00, $00, $00, $00, $00, $00, $00    ; char 255  (unused)

; --- Colour table (32 B), upload to VRAM $2000 --------------------------
; One fg/bg byte per group of 8 chars. fg = high nibble, bg = low nibble.
tileset_color_table:
        .byte $E1, $A1, $B1, $71, $F1, $F1, $F1, $F1, $F1, $F1, $F1, $F1, $F1, $F1, $F1, $F1, $F1, $F1, $F1, $F1, $F1, $F1, $F1, $F1, $F1, $F1, $F1, $F1, $F1, $F1, $F1, $F1
