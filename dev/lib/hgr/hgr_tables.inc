; =============================================
; hgr_tables.inc — HGR pixel lookup tables
; GEN2 Color Graphics Card (280x192, Apple II layout)
; =============================================
;
; Include this file in any GEN2 program that needs
; fast per-pixel access to the HGR framebuffer.
;
; Required zero-page variables (declare in your program):
;   cur_x:  .res 1    ; pixel X coordinate (0-255)
;   cur_y:  .res 1    ; pixel Y coordinate (0-191)
;   ptr_lo: .res 1    ; indirect pointer low byte
;   ptr_hi: .res 1    ; indirect pointer high byte
;
; Provides:
;   plot_pixel  — set pixel at (cur_x, cur_y), ~45 cycles
;   clear_hgr   — zero out $2000-$3FFF
;
; Data: 896 bytes (4 lookup tables)
; Code: ~30 bytes
; =============================================

; =============================================
; PLOT PIXEL: set pixel at (cur_x, cur_y)
; Uses table lookups — ~45 cycles total.
; Preserves: cur_x, cur_y
; Trashes: A, X, Y, ptr_lo, ptr_hi
; =============================================
plot_pixel:
        LDX cur_y
        LDA hgr_lo,X
        STA ptr_lo
        LDA hgr_hi,X
        STA ptr_hi
        LDX cur_x
        LDA hgr_mask,X      ; pixel bitmask
        LDY hgr_col,X       ; byte column
        ORA (ptr_lo),Y       ; merge with existing pixels
        STA (ptr_lo),Y       ; write back
        RTS

; =============================================
; UMUL8: unsigned 8×8 → 16-bit multiply
; Input: A = multiplicand, X = multiplier
; Output: A = low byte, X = high byte
; Standard 6502 shift-and-add (ref: 6502.org)
; =============================================
umul8:
        STA mul_tmp
        STX mul_res0
        LDA #$00
        LDX #8
        LSR mul_res0        ; extract first multiplier bit
@uml:   BCC @noad
        CLC
        ADC mul_tmp
@noad:  ROR A               ; shift result high byte
        ROR mul_res0        ; shift result low + next multiplier bit → carry
        DEX
        BNE @uml
        TAX                 ; X = high byte
        LDA mul_res0        ; A = low byte
        RTS

; Zero page for umul8 (declare in your program if using umul8 directly):
;   mul_tmp:  .res 1
;   mul_res0: .res 1

; =============================================
; CLEAR HGR: zero out $2000-$3FFF (8 KB)
; Trashes: A, X, Y, ptr_lo, ptr_hi
; =============================================
clear_hgr:
        LDA #$00
        TAY
        STA ptr_lo
        LDX #$20
        STX ptr_hi
@clr:   STA (ptr_lo),Y
        INY
        BNE @clr
        INC ptr_hi
        LDX ptr_hi
        CPX #$40
        BNE @clr
        RTS

; =============================================
; LOOKUP TABLES (896 bytes total)
; =============================================

; --- hgr_lo[192]: scanline base address low byte ---
; addr = $2000 + (y%8)*$0400 + ((y/8)%8)*$80 + (y/64)*$28
hgr_lo:
        .byte $00, $00, $00, $00, $00, $00, $00, $00, $80, $80, $80, $80, $80, $80, $80, $80
        .byte $00, $00, $00, $00, $00, $00, $00, $00, $80, $80, $80, $80, $80, $80, $80, $80
        .byte $00, $00, $00, $00, $00, $00, $00, $00, $80, $80, $80, $80, $80, $80, $80, $80
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        .byte $50, $50, $50, $50, $50, $50, $50, $50, $D0, $D0, $D0, $D0, $D0, $D0, $D0, $D0

; --- hgr_hi[192]: scanline base address high byte ---
hgr_hi:
        .byte $20, $24, $28, $2C, $30, $34, $38, $3C, $20, $24, $28, $2C, $30, $34, $38, $3C
        .byte $21, $25, $29, $2D, $31, $35, $39, $3D, $21, $25, $29, $2D, $31, $35, $39, $3D
        .byte $22, $26, $2A, $2E, $32, $36, $3A, $3E, $22, $26, $2A, $2E, $32, $36, $3A, $3E
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        .byte $23, $27, $2B, $2F, $33, $37, $3B, $3F, $23, $27, $2B, $2F, $33, $37, $3B, $3F

; --- hgr_col[256]: x / 7 → byte column (0-36) ---
hgr_col:
        .byte $00, $00, $00, $00, $00, $00, $00, $01, $01, $01, $01, $01, $01, $01, $02, $02
        .byte $02, $02, $02, $02, $02, $03, $03, $03, $03, $03, $03, $03, $04, $04, $04, $04
        .byte $04, $04, $04, $05, $05, $05, $05, $05, $05, $05, $06, $06, $06, $06, $06, $06
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        .byte $22, $22, $22, $22, $22, $23, $23, $23, $23, $23, $23, $23, $24, $24, $24, $24

; --- hgr_mask[256]: 1 << (x % 7) → pixel bitmask ---
hgr_mask:
        .byte $01, $02, $04, $08, $10, $20, $40, $01, $02, $04, $08, $10, $20, $40, $01, $02
        .byte $04, $08, $10, $20, $40, $01, $02, $04, $08, $10, $20, $40, $01, $02, $04, $08
        .byte $10, $20, $40, $01, $02, $04, $08, $10, $20, $40, $01, $02, $04, $08, $10, $20
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        .byte $04, $08, $10, $20, $40, $01, $02, $04, $08, $10, $20, $40, $01, $02, $04, $08
