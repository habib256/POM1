; =============================================================================
; bbfont_cp437.inc — CP437 linear table for GEN2 HGR (POM1)
; =============================================================================
; $00-$1F, $80-$FF: fonts/font_codepage_437_8x8.png (7 cols, bit0=left).
; $20-$7F: fonts/fontbb.s (Beautiful Boot) — AND #$7F + reverse 8 rows
;         (DrawChar / GEN2 convention, same as HGR_Sokoban_bbfont.inc).
; =============================================================================

HGR_BBFONT_BYTES_PER_GLYPH = 8
HGR_BBFONT_GLYPH_COUNT     = 256

HGR_BBFont:
        .byte $00,$00,$00,$00,$00,$00,$00,$00 ; $00 PNG
        .byte $7E,$01,$25,$01,$3D,$19,$01,$7E ; $01 PNG
        .byte $7E,$7F,$5B,$7F,$43,$67,$7F,$7E ; $02 PNG
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        .byte $00,$00,$00,$00,$00,$00,$00,$00 ; $FF PNG

.assert (* - HGR_BBFont) = (HGR_BBFONT_GLYPH_COUNT * HGR_BBFONT_BYTES_PER_GLYPH), error
