; ============================================================================
; c64font_tms.inc -- C64-style 8x8 font, TMS9918 Text-Mode pattern encoding.
; GENERATED by tools/build_c64font_tms.py from dev/lib/tms9918c/c64font.c.
; DO NOT EDIT -- rerun the tool to refresh after changing the master.
; ----------------------------------------------------------------------------
; ASCII 0x20-0x7F (96 glyphs), 8 bytes/glyph, MSB = leftmost pixel. The C64
; master centres each glyph in 8 px (content in bits 6..1); TMS9918 Text Mode
; F1 only displays the leftmost 6 px (pattern bits 7..2), so every byte is
; shifted LEFT one bit here to land the glyph in the visible 6-px cell. This
; is the thinner C64 alternative to the heavier bbfont_tms.inc.
;
; Inline data fragment (no .export, no .ifndef guard) -- `.include` it at the
; pattern-table location in the ROM image, then index (ch-0x20)*8 like the C
; runtime indexes c64font's FONT[]. cc65 include path: dev/lib/tms9918/.
; ============================================================================

TMS_C64FONT_FIRST_CHAR      = $20
TMS_C64FONT_GLYPH_COUNT     = 96
TMS_C64FONT_BYTES_PER_GLYPH = 8

tms_c64font:
        .byte $00,$00,$00,$00,$00,$00,$00,$00 ; $20 ' '
        .byte $30,$30,$30,$30,$00,$00,$30,$00 ; $21 '!'
        .byte $CC,$CC,$CC,$00,$00,$00,$00,$00 ; $22 '"'
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        .byte $66,$32,$98,$CC,$66,$32,$98,$CC ; $7F ?
