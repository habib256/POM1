; ============================================================================
; bbfont_tms.inc -- Beautiful Boot 8x8 font, TMS9918 pattern-table encoding.
; GENERATED by tools/build_shared_font.py from dev/lib/gen2/bbfont_cp437.inc.
; DO NOT EDIT -- rerun the tool to refresh after changing the master.
; ----------------------------------------------------------------------------
; ASCII 0x20-0x7F (96 glyphs), 8 bytes/glyph, MSB = leftmost pixel (TMS pattern
; table convention). This is the bit-reverse of the HGR 7 px/byte encoding in
; gen2_bbfont.inc: master bit 0 (left) -> bit 7 (left); the empty 8th column of
; the 7-px BB glyph lands in bit 0 (a 1-px inter-char gap).
;
; Inline data fragment (no .export, no .ifndef guard) -- `.include` it at the
; pattern-table location in the ROM image, then index (ch-0x20)*8 like the C
; runtime indexes c64font's FONT[]. cc65 include path: dev/lib/tms9918/.
; ============================================================================

TMS_BBFONT_FIRST_CHAR      = $20
TMS_BBFONT_GLYPH_COUNT     = 96
TMS_BBFONT_BYTES_PER_GLYPH = 8

tms_bbfont:
        .byte $00,$00,$00,$00,$00,$00,$00,$00 ; $20 ' '
        .byte $E0,$E0,$E0,$E0,$00,$E0,$E0,$00 ; $21 '!'
        .byte $6C,$6C,$24,$6C,$00,$00,$00,$00 ; $22 '"'
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        .byte $00,$00,$00,$00,$00,$00,$00,$00 ; $7F ?
