; ============================================================================
; font_hud8x8.inc -- shared 8x8 HUD mini-font for TMS9918 games
; GENERATED by tools/build_shared_font.py from dev/lib/gen2/bbfont_cp437.inc.
; DO NOT EDIT -- rerun the tool to refresh after changing the master.
; ----------------------------------------------------------------------------
; The HUD overlay font the TMS9918 game ROMs (Snake, Sokoban) use to draw
; on-screen score/title text. Each glyph is one 8x8 cell, MSB = leftmost pixel,
; 1 byte per scanline (8 bytes/glyph) -- the bit-reverse of the master's HGR
; 7 px/byte encoding, so the HUD now shares the Beautiful Boot font with the
; GEN2 HGR side from a SINGLE source (Axe 2 of the lib factoring).
;
; Emits ONLY the 37 glyphs at TMS char codes 56..92, in their on-ROM order:
;
;     M V : 0 1 2 3 4 5 6 7 8 9 S O K B A N P R E L <space> G H T D Y I U Q
;     W Z C X F
;
; The two slim parenthesis glyphs (char 93 '(' and char 94 ')') are NOT
; included here -- each project keeps its own '(' / ')' as a LOCAL OVERRIDE
; placed *immediately after* this include, so the on-ROM byte layout (char
; 56..94 contiguous, 8 bytes each) is preserved exactly.
;
; Usage (both projects):
;     hud_patterns:
;             .include "font_hud8x8.inc"      ; emits chars 56..92 (tms_hud_font)
;             ; char 93 '(' -- project-specific
;             .byte ...
;             ; char 94 ')' -- project-specific
;             .byte ...
;
; `tms_hud_font` is a plain label before the data -- it adds no bytes, so
; `hud_patterns` still points at char 56 and `hud_patterns+256` still indexes
; the second VRAM copy half exactly as before. cc65 include path:
; dev/lib/tms9918/  (-I ../../lib/tms9918). No .ifndef guard -- inline fragment
; meant to be included exactly once at the font's location in the ROM image.
; ============================================================================

tms_hud_font:
        ; char 56 'M'
        .byte $CC, $FC, $CC, $CC, $CC, $CC, $CC, $00
        ; char 57 'V'
        .byte $CC, $CC, $CC, $CC, $CC, $78, $30, $00
        ; char 58 ':'
        .byte $00, $38, $38, $00, $00, $38, $38, $00
        ; char 59 '0'
        .byte $78, $CC, $CC, $CC, $CC, $CC, $78, $00
        ; char 60 '1'
        .byte $30, $70, $F0, $30, $30, $30, $FC, $00
        ; char 61 '2'
        .byte $78, $FC, $CC, $1C, $70, $FC, $FC, $00
        ; char 62 '3'
        .byte $78, $FC, $0C, $7C, $0C, $FC, $78, $00
        ; char 63 '4'
        .byte $1C, $3C, $6C, $CC, $FC, $0C, $0C, $00
        ; char 64 '5'
        .byte $FC, $FC, $C0, $F8, $0C, $FC, $78, $00
        ; char 65 '6'
        .byte $78, $FC, $C0, $F8, $CC, $FC, $78, $00
        ; char 66 '7'
        .byte $FC, $FC, $0C, $18, $30, $30, $30, $00
        ; char 67 '8'
        .byte $78, $FC, $CC, $78, $CC, $FC, $78, $00
        ; char 68 '9'
        .byte $78, $FC, $CC, $7C, $0C, $FC, $78, $00
        ; char 69 'S'
        .byte $78, $CC, $C0, $78, $0C, $CC, $78, $00
        ; char 70 'O'
        .byte $78, $FC, $CC, $CC, $CC, $FC, $78, $00
        ; char 71 'K'
        .byte $CC, $DC, $F8, $F0, $F8, $DC, $CC, $00
        ; char 72 'B'
        .byte $F8, $FC, $CC, $F8, $CC, $FC, $F8, $00
        ; char 73 'A'
        .byte $78, $FC, $CC, $FC, $FC, $CC, $CC, $00
        ; char 74 'N'
        .byte $CC, $CC, $EC, $FC, $DC, $CC, $CC, $00
        ; char 75 'P'
        .byte $F8, $FC, $CC, $FC, $F8, $C0, $C0, $00
        ; char 76 'R'
        .byte $F8, $FC, $CC, $FC, $F8, $DC, $CC, $00
        ; char 77 'E'
        .byte $FC, $FC, $C0, $F8, $C0, $FC, $FC, $00
        ; char 78 'L'
        .byte $C0, $C0, $C0, $C0, $C0, $FC, $FC, $00
        ; char 79 ' '
        .byte $00, $00, $00, $00, $00, $00, $00, $00
        ; char 80 'G'
        .byte $78, $FC, $C0, $DC, $CC, $FC, $78, $00
        ; char 81 'H'
        .byte $CC, $CC, $CC, $FC, $FC, $CC, $CC, $00
        ; char 82 'T'
        .byte $FC, $FC, $30, $30, $30, $30, $30, $00
        ; char 83 'D'
        .byte $F8, $FC, $CC, $CC, $CC, $FC, $F8, $00
        ; char 84 'Y'
        .byte $CC, $CC, $CC, $78, $30, $30, $30, $00
        ; char 85 'I'
        .byte $FC, $FC, $30, $30, $30, $FC, $FC, $00
        ; char 86 'U'
        .byte $CC, $CC, $CC, $CC, $CC, $FC, $78, $00
        ; char 87 'Q'
        .byte $78, $CC, $CC, $CC, $DC, $78, $1C, $00
        ; char 88 'W'
        .byte $CC, $CC, $CC, $CC, $CC, $FC, $CC, $00
        ; char 89 'Z'
        .byte $FC, $FC, $18, $30, $60, $FC, $FC, $00
        ; char 90 'C'
        .byte $78, $FC, $CC, $C0, $CC, $FC, $78, $00
        ; char 91 'X'
        .byte $CC, $CC, $78, $30, $78, $CC, $CC, $00
        ; char 92 'F'
        .byte $FC, $FC, $C0, $F8, $F8, $C0, $C0, $00
