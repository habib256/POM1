; =============================================================================
; bbfont_ascii5f.inc -- ASCII $20-$5F subset of the Beautiful Boot HGR font.
; Generated by tools/build_hgr_font_subset.py from bbfont_cp437.inc.
; DO NOT EDIT BY HAND -- rerun the generator instead.
; -----------------------------------------------------------------------------
; 64 printable glyphs (space .. '_'), 8 bytes each, bit 0 = leftmost pixel,
; 8 rows top->bottom. Index a glyph by (char - $20). Byte-aligned STA blit.
; =============================================================================

HGR_FONT5F_BYTES_PER_GLYPH = 8
HGR_FONT5F_FIRST_CHAR      = $20

HGR_Font5F:
        .byte $00,$00,$00,$00,$00,$00,$00,$00  ; $20 SPACE
        .byte $07,$07,$07,$07,$00,$07,$07,$00  ; $21 '!'
        .byte $36,$36,$24,$36,$00,$00,$00,$00  ; $22 '"'
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        .byte $00,$00,$00,$00,$00,$7F,$7F,$00  ; $5F '_'
