; =============================================
; hgr_scanline.inc - HGR scanline base-address tables (384 bytes)
; =============================================
; Split out of hgr_tables.inc. hgr_lo[192] / hgr_hi[192] = base address of
; scanline y in the GEN2 HGR framebuffer (Apple II interleaved layout):
;   addr[y] = $2000 + (y%8)*$0400 + ((y/8)%8)*$80 + (y/64)*$28
; =============================================
hgr_lo:
        .byte $00, $00, $00, $00, $00, $00, $00, $00, $80, $80, $80, $80, $80, $80, $80, $80
        .byte $00, $00, $00, $00, $00, $00, $00, $00, $80, $80, $80, $80, $80, $80, $80, $80
        .byte $00, $00, $00, $00, $00, $00, $00, $00, $80, $80, $80, $80, $80, $80, $80, $80
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        .byte $50, $50, $50, $50, $50, $50, $50, $50, $D0, $D0, $D0, $D0, $D0, $D0, $D0, $D0

; --- hgr_hi[192]: scanline base address high byte ---
hgr_hi:
        .byte $20, $24, $28, $2C, $30, $34, $38, $3C, $20, $24, $28, $2C, $30, $34, $38, $3C
        .byte $21, $25, $29, $2D, $31, $35, $39, $3D, $21, $25, $29, $2D, $31, $35, $39, $3D
        .byte $22, $26, $2A, $2E, $32, $36, $3A, $3E, $22, $26, $2A, $2E, $32, $36, $3A, $3E
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        .byte $23, $27, $2B, $2F, $33, $37, $3B, $3F, $23, $27, $2B, $2F, $33, $37, $3B, $3F
