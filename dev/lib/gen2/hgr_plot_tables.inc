; =============================================
; hgr_plot_tables.inc - HGR per-pixel column/mask tables (512 bytes)
; =============================================
; Split out of hgr_tables.inc. hgr_col[256] = x/7 -> byte column;
; hgr_mask[256] = 1 << (x%7) -> pixel bitmask. Used by plot_pixel.
; =============================================
hgr_col:
        .byte $00, $00, $00, $00, $00, $00, $00, $01, $01, $01, $01, $01, $01, $01, $02, $02
        .byte $02, $02, $02, $02, $02, $03, $03, $03, $03, $03, $03, $03, $04, $04, $04, $04
        .byte $04, $04, $04, $05, $05, $05, $05, $05, $05, $05, $06, $06, $06, $06, $06, $06
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        .byte $22, $22, $22, $22, $22, $23, $23, $23, $23, $23, $23, $23, $24, $24, $24, $24

; --- hgr_mask[256]: 1 << (x % 7) → pixel bitmask ---
hgr_mask:
        .byte $01, $02, $04, $08, $10, $20, $40, $01, $02, $04, $08, $10, $20, $40, $01, $02
        .byte $04, $08, $10, $20, $40, $01, $02, $04, $08, $10, $20, $40, $01, $02, $04, $08
        .byte $10, $20, $40, $01, $02, $04, $08, $10, $20, $40, $01, $02, $04, $08, $10, $20
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        .byte $04, $08, $10, $20, $40, $01, $02, $04, $08, $10, $20, $40, $01, $02, $04, $08
