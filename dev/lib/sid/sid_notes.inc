;============================================================================
; sid_notes.inc -- 96-note frequency table (C0..B7) for SID at 1.022727 MHz
;============================================================================
; Generated by tools/build_sid_notes.py — do not edit by hand.
; Index 0 = C0 (16.35 Hz), index 95 = B7 (3951 Hz). 12 notes per octave,
; standard equal-temperament tuning (A4 = 440 Hz at index 57).
;
; SID register format: 16-bit frequency value, lo byte at $C800/$C807/$C80E
; (per voice), hi byte at +1. Computed as:
;   sid_value = round(freq_hz * 2^24 / CPU_CLOCK_HZ)
; where CPU_CLOCK_HZ = 1 022 727 (real Apple-1 clock; same in POM1).
;============================================================================

sid_notes_lo:
        .byte   $0C, $1C, $2D, $3F, $52, $66, $7B, $92, $AA, $C3, $DE, $FA    ; octave 0
        .byte   $18, $38, $5A, $7E, $A4, $CC, $F7, $24, $54, $86, $BC, $F5    ; octave 1
        .byte   $31, $71, $B4, $FC, $48, $98, $ED, $48, $A7, $0C, $78, $E9    ; octave 2
        .byte   $62, $E2, $69, $F8, $90, $30, $DB, $8F, $4E, $19, $F0, $D3    ; octave 3
        .byte   $C4, $C3, $D1, $F0, $1F, $61, $B6, $1E, $9D, $32, $DF, $A6    ; octave 4
        .byte   $88, $86, $A3, $E0, $3F, $C2, $6B, $3D, $3A, $64, $BE, $4C    ; octave 5
        .byte   $0F, $0C, $46, $BF, $7D, $84, $D6, $7A, $73, $C8, $7D, $97    ; octave 6
        .byte   $1E, $18, $8B, $7F, $FB, $07, $AC, $F4, $E7, $8F, $F9, $2F    ; octave 7

sid_notes_hi:
        .byte   $01, $01, $01, $01, $01, $01, $01, $01, $01, $01, $01, $01    ; octave 0
        .byte   $02, $02, $02, $02, $02, $02, $02, $03, $03, $03, $03, $03    ; octave 1
        .byte   $04, $04, $04, $04, $05, $05, $05, $06, $06, $07, $07, $07    ; octave 2
        .byte   $08, $08, $09, $09, $0A, $0B, $0B, $0C, $0D, $0E, $0E, $0F    ; octave 3
        .byte   $10, $11, $12, $13, $15, $16, $17, $19, $1A, $1C, $1D, $1F    ; octave 4
        .byte   $21, $23, $25, $27, $2A, $2C, $2F, $32, $35, $38, $3B, $3F    ; octave 5
        .byte   $43, $47, $4B, $4F, $54, $59, $5E, $64, $6A, $70, $77, $7E    ; octave 6
        .byte   $86, $8E, $96, $9F, $A8, $B3, $BD, $C8, $D4, $E1, $EE, $FD    ; octave 7

; --- Note index equates (MIDI-style numbering from C0 = 0) ------------------
NOTE_C0 = 0
NOTE_CS0 = 1
NOTE_D0 = 2
NOTE_DS0 = 3
NOTE_E0 = 4
NOTE_F0 = 5
NOTE_FS0 = 6
NOTE_G0 = 7
NOTE_GS0 = 8
NOTE_A0 = 9
NOTE_AS0 = 10
NOTE_B0 = 11
NOTE_C1 = 12
NOTE_CS1 = 13
NOTE_D1 = 14
NOTE_DS1 = 15
NOTE_E1 = 16
NOTE_F1 = 17
NOTE_FS1 = 18
NOTE_G1 = 19
NOTE_GS1 = 20
NOTE_A1 = 21
NOTE_AS1 = 22
NOTE_B1 = 23
NOTE_C2 = 24
NOTE_CS2 = 25
NOTE_D2 = 26
NOTE_DS2 = 27
NOTE_E2 = 28
NOTE_F2 = 29
NOTE_FS2 = 30
NOTE_G2 = 31
NOTE_GS2 = 32
NOTE_A2 = 33
NOTE_AS2 = 34
NOTE_B2 = 35
NOTE_C3 = 36
NOTE_CS3 = 37
NOTE_D3 = 38
NOTE_DS3 = 39
NOTE_E3 = 40
NOTE_F3 = 41
NOTE_FS3 = 42
NOTE_G3 = 43
NOTE_GS3 = 44
NOTE_A3 = 45
NOTE_AS3 = 46
NOTE_B3 = 47
NOTE_C4 = 48
NOTE_CS4 = 49
NOTE_D4 = 50
NOTE_DS4 = 51
NOTE_E4 = 52
NOTE_F4 = 53
NOTE_FS4 = 54
NOTE_G4 = 55
NOTE_GS4 = 56
NOTE_A4 = 57
NOTE_AS4 = 58
NOTE_B4 = 59
NOTE_C5 = 60
NOTE_CS5 = 61
NOTE_D5 = 62
NOTE_DS5 = 63
NOTE_E5 = 64
NOTE_F5 = 65
NOTE_FS5 = 66
NOTE_G5 = 67
NOTE_GS5 = 68
NOTE_A5 = 69
NOTE_AS5 = 70
NOTE_B5 = 71
NOTE_C6 = 72
NOTE_CS6 = 73
NOTE_D6 = 74
NOTE_DS6 = 75
NOTE_E6 = 76
NOTE_F6 = 77
NOTE_FS6 = 78
NOTE_G6 = 79
NOTE_GS6 = 80
NOTE_A6 = 81
NOTE_AS6 = 82
NOTE_B6 = 83
NOTE_C7 = 84
NOTE_CS7 = 85
NOTE_D7 = 86
NOTE_DS7 = 87
NOTE_E7 = 88
NOTE_F7 = 89
NOTE_FS7 = 90
NOTE_G7 = 91
NOTE_GS7 = 92
NOTE_A7 = 93
NOTE_AS7 = 94
NOTE_B7 = 95
