; ============================================================================
; sid_song_bank50.inc -- 50 famous/varied melodies for sid_player.asm.
; ----------------------------------------------------------------------------
; GENERATED by tools/build_sid_song_bank.py -- DO NOT EDIT (rerun the tool).
; Rows: .byte note, ctrl(waveform), frames ; note $FE=off $FF=tie, frames 0
; ends. Play: LDX #<song_nokia / LDY #>song_nokia / JSR sid_play_start, then
; JSR sid_play_tick per frame. The SID tracker loads the same 50 in its bank
; browser (mirror: src/sidtrack/SidSongBank.h).
; ============================================================================

song_nokia:
        .byte $40, $40, $06   ; E5
        .byte $3E, $40, $06   ; D5
        .byte $36, $40, $0C   ; F#4
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        .byte $00, $00, $00   ; end

song_fur_elise:
        .byte $40, $10, $06   ; E5
        .byte $3F, $10, $06   ; D#5
        .byte $40, $10, $06   ; E5
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        .byte $00, $00, $00   ; end

song_iphone_marimba:
        .byte $34, $10, $06   ; E4
        .byte $39, $10, $06   ; A4
        .byte $3D, $10, $06   ; C#5
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        .byte $00, $00, $00   ; end

song_crazy_frog:
        .byte $35, $40, $0C   ; F4
        .byte $FE, $00, $03   ; ---
        .byte $3A, $40, $06   ; A#4
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        .byte $00, $00, $00   ; end

song_ode_to_joy:
        .byte $34, $10, $0C   ; E4
        .byte $34, $10, $0C   ; E4
        .byte $35, $10, $0C   ; F4
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        .byte $00, $00, $00   ; end

song_mario:
        .byte $40, $40, $06   ; E5
        .byte $40, $40, $06   ; E5
        .byte $FE, $00, $06   ; ---
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        .byte $00, $00, $00   ; end

song_tetris:
        .byte $40, $40, $0C   ; E5
        .byte $3B, $40, $06   ; B4
        .byte $3C, $40, $06   ; C5
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        .byte $00, $00, $00   ; end

song_beethoven5:
        .byte $37, $20, $06   ; G4
        .byte $37, $20, $06   ; G4
        .byte $37, $20, $06   ; G4
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        .byte $00, $00, $00   ; end

song_twinkle:
        .byte $30, $10, $0C   ; C4
        .byte $30, $10, $0C   ; C4
        .byte $37, $10, $0C   ; G4
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        .byte $00, $00, $00   ; end

song_jingle_bells:
        .byte $34, $40, $0C   ; E4
        .byte $34, $40, $0C   ; E4
        .byte $34, $40, $18   ; E4
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        .byte $00, $00, $00   ; end

song_happy_birthday:
        .byte $30, $10, $06   ; C4
        .byte $30, $10, $06   ; C4
        .byte $32, $10, $0C   ; D4
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        .byte $00, $00, $00   ; end

song_mary_lamb:
        .byte $34, $10, $0C   ; E4
        .byte $32, $10, $0C   ; D4
        .byte $30, $10, $0C   ; C4
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        .byte $00, $00, $00   ; end

song_row_boat:
        .byte $30, $10, $0C   ; C4
        .byte $30, $10, $0C   ; C4
        .byte $30, $10, $12   ; C4
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        .byte $00, $00, $00   ; end

song_frere_jacques:
        .byte $30, $10, $0C   ; C4
        .byte $32, $10, $0C   ; D4
        .byte $34, $10, $0C   ; E4
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        .byte $00, $00, $00   ; end

song_london_bridge:
        .byte $37, $10, $12   ; G4
        .byte $39, $10, $06   ; A4
        .byte $37, $10, $0C   ; G4
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        .byte $00, $00, $00   ; end

song_old_macdonald:
        .byte $37, $10, $0C   ; G4
        .byte $37, $10, $0C   ; G4
        .byte $37, $10, $0C   ; G4
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        .byte $00, $00, $00   ; end

song_silent_night:
        .byte $37, $10, $12   ; G4
        .byte $39, $10, $06   ; A4
        .byte $37, $10, $0C   ; G4
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        .byte $00, $00, $00   ; end

song_we_wish_xmas:
        .byte $32, $40, $0C   ; D4
        .byte $37, $40, $0C   ; G4
        .byte $37, $40, $0C   ; G4
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        .byte $00, $00, $00   ; end

song_auld_lang_syne:
        .byte $30, $10, $0C   ; C4
        .byte $35, $10, $12   ; F4
        .byte $35, $10, $06   ; F4
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        .byte $00, $00, $00   ; end

song_amazing_grace:
        .byte $37, $10, $06   ; G4
        .byte $3C, $10, $12   ; C5
        .byte $40, $10, $06   ; E5
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        .byte $00, $00, $00   ; end

song_when_saints:
        .byte $30, $40, $0C   ; C4
        .byte $34, $40, $0C   ; E4
        .byte $35, $40, $0C   ; F4
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        .byte $00, $00, $00   ; end

song_yankee_doodle:
        .byte $30, $40, $0C   ; C4
        .byte $30, $40, $0C   ; C4
        .byte $32, $40, $0C   ; D4
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        .byte $00, $00, $00   ; end

song_oh_susanna:
        .byte $30, $10, $06   ; C4
        .byte $32, $10, $06   ; D4
        .byte $34, $10, $0C   ; E4
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        .byte $00, $00, $00   ; end

song_clementine:
        .byte $30, $10, $06   ; C4
        .byte $30, $10, $0C   ; C4
        .byte $30, $10, $12   ; C4
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        .byte $00, $00, $00   ; end

song_camptown:
        .byte $37, $40, $0C   ; G4
        .byte $37, $40, $0C   ; G4
        .byte $34, $40, $0C   ; E4
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        .byte $00, $00, $00   ; end

song_la_cucaracha:
        .byte $30, $40, $0C   ; C4
        .byte $30, $40, $0C   ; C4
        .byte $30, $40, $0C   ; C4
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        .byte $00, $00, $00   ; end

song_pop_weasel:
        .byte $30, $10, $0C   ; C4
        .byte $30, $10, $0C   ; C4
        .byte $32, $10, $0C   ; D4
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        .byte $00, $00, $00   ; end

song_this_old_man:
        .byte $37, $10, $0C   ; G4
        .byte $34, $10, $0C   ; E4
        .byte $37, $10, $0C   ; G4
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        .byte $00, $00, $00   ; end

song_greensleeves:
        .byte $39, $10, $0C   ; A4
        .byte $3C, $10, $0C   ; C5
        .byte $3E, $10, $0C   ; D5
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        .byte $00, $00, $00   ; end

song_scarborough:
        .byte $39, $10, $18   ; A4
        .byte $39, $10, $0C   ; A4
        .byte $40, $10, $18   ; E5
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        .byte $00, $00, $00   ; end

song_turkey_straw:
        .byte $3C, $40, $0C   ; C5
        .byte $3B, $40, $0C   ; B4
        .byte $39, $40, $0C   ; A4
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        .byte $00, $00, $00   ; end

song_skip_to_lou:
        .byte $37, $10, $0C   ; G4
        .byte $34, $10, $0C   ; E4
        .byte $34, $10, $18   ; E4
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        .byte $00, $00, $00   ; end

song_bingo:
        .byte $30, $10, $0C   ; C4
        .byte $30, $10, $0C   ; C4
        .byte $37, $10, $0C   ; G4
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        .byte $00, $00, $00   ; end

song_itsy_spider:
        .byte $37, $10, $0C   ; G4
        .byte $3C, $10, $0C   ; C5
        .byte $3C, $10, $0C   ; C5
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        .byte $00, $00, $00   ; end

song_wheels_bus:
        .byte $30, $40, $0C   ; C4
        .byte $35, $40, $0C   ; F4
        .byte $35, $40, $0C   ; F4
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        .byte $00, $00, $00   ; end

song_hot_cross_buns:
        .byte $34, $10, $0C   ; E4
        .byte $32, $10, $0C   ; D4
        .byte $30, $10, $18   ; C4
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        .byte $00, $00, $00   ; end

song_baa_black_sheep:
        .byte $30, $10, $0C   ; C4
        .byte $30, $10, $0C   ; C4
        .byte $37, $10, $0C   ; G4
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        .byte $00, $00, $00   ; end

song_hickory_dock:
        .byte $39, $40, $0C   ; A4
        .byte $3B, $40, $0C   ; B4
        .byte $3C, $40, $0C   ; C5
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        .byte $00, $00, $00   ; end

song_rockabye:
        .byte $35, $10, $0C   ; F4
        .byte $39, $10, $12   ; A4
        .byte $35, $10, $06   ; F4
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        .byte $00, $00, $00   ; end

song_brahms_lullaby:
        .byte $34, $10, $06   ; E4
        .byte $34, $10, $06   ; E4
        .byte $37, $10, $0C   ; G4
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        .byte $00, $00, $00   ; end

song_canon_d:
        .byte $42, $10, $0C   ; F#5
        .byte $40, $10, $0C   ; E5
        .byte $3E, $10, $0C   ; D5
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        .byte $00, $00, $00   ; end

song_blue_danube:
        .byte $32, $10, $0C   ; D4
        .byte $37, $10, $0C   ; G4
        .byte $3B, $10, $18   ; B4
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        .byte $00, $00, $00   ; end

song_william_tell:
        .byte $34, $40, $06   ; E4
        .byte $34, $40, $06   ; E4
        .byte $34, $40, $0C   ; E4
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        .byte $00, $00, $00   ; end

song_mountain_king:
        .byte $2F, $20, $0C   ; B3
        .byte $31, $20, $0C   ; C#4
        .byte $32, $20, $0C   ; D4
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        .byte $00, $00, $00   ; end

song_habanera:
        .byte $3E, $10, $0C   ; D5
        .byte $3D, $10, $0C   ; C#5
        .byte $3C, $10, $0C   ; C5
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        .byte $00, $00, $00   ; end

song_zarathustra:
        .byte $30, $20, $18   ; C4
        .byte $37, $20, $18   ; G4
        .byte $3C, $20, $18   ; C5
        .byte $40, $20, $12   ; E5
        .byte $3F, $20, $30   ; D#5
        .byte $00, $00, $00   ; end

song_valkyries:
        .byte $2F, $20, $06   ; B3
        .byte $34, $20, $12   ; E4
        .byte $2F, $20, $06   ; B3
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        .byte $00, $00, $00   ; end

song_greensleeves2:
        .byte $40, $10, $12   ; E5
        .byte $41, $10, $06   ; F5
        .byte $43, $10, $0C   ; G5
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        .byte $00, $00, $00   ; end

song_taps:
        .byte $2B, $10, $0C   ; G3
        .byte $2B, $10, $06   ; G3
        .byte $30, $10, $24   ; C4
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        .byte $00, $00, $00   ; end

song_maribou_marimba:
        .byte $39, $10, $06   ; A4
        .byte $40, $10, $06   ; E5
        .byte $45, $10, $06   ; A5
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        .byte $00, $00, $00   ; end

