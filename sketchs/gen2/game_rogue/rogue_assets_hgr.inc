; ============================================================================
; rogue_assets_hgr.inc -- generated by tools/build_rogue_hgr_assets.py
; ----------------------------------------------------------------------------
; GEN2 HGR asset pack for game_rogue: 8 map tiles + 14 entity/item sprites
; (14x16 px, 2 bytes x 16 rows = 32 B each) + the 28x32 boss (4 bytes x 32
; rows = 128 B). Converted from the TMS9918 art (Quale's SCROLL-O-SPRITES
; CC-BY-3.0 + Hexany Ives' Monster Menagerie CC0). HGR packing: 7 px/byte,
; bit 0 = leftmost pixel, bit 7 (palette group) clear.
;
; CHAR_* keep their TMS values so tile_char_base needs no edit: the HGR
; tile bitmap for dense id X lives at rogue_tiles_hgr + tile_char_base[X]*8.
; Sprites keep their TMS slot numbers (0,4,8..52): bitmap at
; rogue_sprites_hgr + slot*8.
;
; DO NOT EDIT BY HAND. Re-run the script if the source art changes.
; ============================================================================

CHAR_EMPTY          = 0
CHAR_WALL           = 4
CHAR_STAIRS_DOWN    = 8
CHAR_DOOR           = 12
CHAR_STAIRS_UP      = 16
CHAR_TRAP_PIT       = 20
CHAR_GOLD           = 24
CHAR_POTION         = 28

; --- map tiles: 8 x (16 rows x 2 bytes) --------------------------------
rogue_tiles_hgr:
; tile empty
        .byte $00, $00, $00, $00, $00, $00, $00, $00
        .byte $00, $00, $00, $00, $00, $00, $00, $00
        .byte $00, $00, $00, $00, $00, $00, $00, $00
        .byte $00, $00, $00, $00, $00, $00, $00, $00
; tile wall
        .byte $7D, $7B, $7D, $7B, $7D, $7B, $7D, $7B
        .byte $7D, $7B, $00, $00, $5F, $3F, $5F, $3F
        .byte $5F, $3F, $5F, $3F, $5F, $3F, $5F, $3F
        .byte $5F, $3F, $00, $00, $7D, $7B, $7D, $7B
; tile stairs_down
        .byte $00, $00, $7F, $7F, $01, $40, $01, $40
        .byte $01, $40, $01, $78, $01, $78, $01, $78
        .byte $61, $7B, $61, $7B, $61, $7B, $6F, $7B
        .byte $6F, $7B, $6F, $7B, $7F, $7F, $00, $00
; tile door
        .byte $00, $00, $68, $0B, $6E, $3B, $6F, $7B
        .byte $6F, $7B, $6F, $7B, $6F, $7B, $6F, $7B
        .byte $79, $7F, $06, $00, $69, $7B, $6F, $7B
        .byte $6F, $7B, $00, $00, $7F, $7F, $00, $00
; tile stairs_up
        .byte $7D, $3C, $7E, $3D, $7F, $3F, $7F, $1B
        .byte $7F, $63, $7C, $61, $7B, $1C, $03, $3E
        .byte $7D, $3E, $7E, $3D, $7F, $1B, $7F, $47
        .byte $7F, $67, $7E, $67, $7C, $1B, $01, $3C
; tile trap_pit
        .byte $00, $00, $7E, $3F, $03, $60, $01, $40
        .byte $21, $48, $31, $4C, $31, $4C, $01, $40
        .byte $01, $40, $11, $44, $19, $46, $19, $46
        .byte $01, $40, $03, $60, $7E, $3F, $00, $00
; tile gold
        .byte $00, $00, $00, $00, $78, $01, $7C, $03
        .byte $7C, $01, $78, $3E, $04, $7F, $38, $7F
        .byte $00, $3E, $00, $41, $00, $3E, $3E, $41
        .byte $7F, $3E, $7F, $00, $3E, $00, $00, $00
; tile potion
        .byte $00, $00, $00, $00, $00, $00, $00, $00
        .byte $60, $03, $30, $06, $70, $07, $60, $03
        .byte $10, $04, $38, $08, $38, $08, $38, $08
        .byte $38, $08, $10, $04, $60, $03, $00, $00

; --- sprites: 14 x (16 rows x 2 bytes), TMS slot = index*4 -------------
rogue_sprites_hgr:
char_guard_hgr:                     ; slot 0
        .byte $40, $41, $70, $67, $78, $0F, $78, $4F
        .byte $48, $49, $08, $48, $38, $4E, $20, $4E
        .byte $2F, $66, $0B, $68, $6B, $1B, $6B, $47
        .byte $4B, $41, $2B, $46, $16, $44, $00, $00
undead_zombie_hgr:                     ; slot 4
        .byte $00, $00, $00, $40, $74, $07, $78, $0F
        .byte $48, $0F, $48, $0B, $78, $0F, $3A, $0D
        .byte $18, $0C, $10, $44, $0E, $18, $75, $2B
        .byte $71, $27, $70, $07, $30, $06, $20, $0A
undead_ghost_hgr:                     ; slot 8
        .byte $00, $00, $70, $07, $78, $0F, $5C, $1F
        .byte $6C, $1D, $7D, $5B, $5F, $7E, $1F, $7C
        .byte $1E, $3C, $3C, $1D, $7C, $1F, $7C, $1F
        .byte $78, $5F, $60, $3F, $00, $00, $00, $00
undead_reaper_hgr:                     ; slot 12
        .byte $00, $00, $63, $0F, $77, $07, $79, $0F
        .byte $09, $08, $45, $11, $45, $11, $35, $16
        .byte $65, $13, $65, $12, $0F, $08, $7E, $1F
        .byte $7D, $3F, $71, $27, $71, $0F, $19, $1B
food_meat_hgr:                     ; slot 16
        .byte $00, $00, $00, $18, $00, $78, $00, $78
        .byte $00, $0C, $00, $06, $60, $03, $78, $06
        .byte $6E, $00, $3D, $02, $3F, $02, $1B, $01
        .byte $0F, $01, $46, $00, $3C, $00, $00, $00
undead_skeleton_hgr:                     ; slot 20
        .byte $00, $00, $70, $07, $78, $0F, $78, $0F
        .byte $48, $09, $48, $09, $38, $0E, $60, $03
        .byte $60, $02, $0C, $18, $72, $27, $46, $31
        .byte $66, $33, $10, $04, $10, $04, $00, $00
item_dagger_hgr:                     ; slot 24
        .byte $00, $00, $00, $00, $00, $00, $00, $18
        .byte $60, $18, $60, $05, $00, $03, $60, $06
        .byte $70, $0D, $38, $0D, $5C, $00, $2C, $00
        .byte $1C, $00, $00, $00, $00, $00, $00, $00
item_potion_hgr:                     ; slot 28
        .byte $00, $00, $00, $00, $00, $00, $00, $00
        .byte $60, $03, $30, $06, $70, $07, $60, $03
        .byte $10, $04, $38, $08, $38, $08, $38, $08
        .byte $38, $08, $10, $04, $60, $03, $00, $00
item_scroll_hgr:                     ; slot 32
        .byte $00, $00, $70, $3F, $48, $7F, $68, $7F
        .byte $08, $00, $78, $1F, $08, $10, $78, $1F
        .byte $18, $18, $78, $1F, $08, $10, $78, $1F
        .byte $1B, $18, $79, $1F, $7E, $0F, $00, $00
item_weapon_hgr:                     ; slot 36
        .byte $00, $00, $00, $78, $00, $7C, $00, $5E
        .byte $00, $4F, $40, $27, $60, $13, $70, $09
        .byte $76, $04, $36, $02, $6C, $01, $18, $00
        .byte $74, $00, $63, $00, $03, $00, $00, $00
item_armor_hgr:                     ; slot 40
        .byte $00, $00, $00, $00, $00, $00, $1E, $3C
        .byte $5E, $3D, $1E, $3C, $1C, $1C, $38, $0E
        .byte $44, $11, $7C, $1F, $7C, $1F, $00, $00
        .byte $78, $0F, $00, $00, $00, $00, $00, $00
item_ring_hgr:                     ; slot 44
        .byte $00, $00, $00, $00, $00, $00, $38, $07
        .byte $3C, $0F, $3C, $1F, $5C, $31, $60, $20
        .byte $3C, $20, $1C, $20, $1C, $20, $18, $10
        .byte $30, $08, $60, $07, $00, $00, $00, $00
troll_goblin_hgr:                     ; slot 48
        .byte $00, $00, $00, $00, $00, $00, $00, $00
        .byte $00, $00, $77, $77, $5E, $3D, $78, $0F
        .byte $70, $07, $08, $08, $7C, $1F, $76, $37
        .byte $72, $27, $36, $36, $26, $32, $20, $02
expl_torch_hgr:                     ; slot 52
        .byte $00, $00, $00, $02, $00, $16, $10, $0F
        .byte $00, $0F, $40, $1F, $64, $19, $70, $1C
        .byte $10, $1E, $20, $0F, $70, $07, $18, $00
        .byte $0C, $00, $06, $00, $03, $00, $00, $00

; --- boss: 32 rows x 4 bytes (28x32 px) --------------------------------
boss_hgr:
        .byte $00, $00, $00, $00, $60, $00, $40, $01
        .byte $30, $00, $00, $03, $30, $00, $00, $03
        .byte $30, $00, $00, $03, $70, $00, $00, $03
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        .byte $00, $00, $00, $00, $00, $00, $00, $00
