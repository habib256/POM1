; ============================================================================
; rogue_assets_hgr_x2.inc -- generated by tools/build_rogue_hgr_assets.py
; ----------------------------------------------------------------------------
; x2 COLOUR pack for game_rogue_x2: 8 map tiles + 14 sprites doubled to
; 28x32 px (4 HGR bytes x 32 rows = 128 B each) and the boss doubled to
; 56x64 px (two 4-byte-wide column halves of 64 rows, 256 B each). The
; NTSC artifact colour is BAKED IN (pixel-parity masks + palette bit,
; byte-column parity fixed by the 4-aligned blit positions).
;
; DO NOT EDIT BY HAND. Re-run the script if the art or palette changes.
; ============================================================================

; --- x2 tiles: 8 x (32 rows x 4 bytes), offset = tile_char_base*32 -----
rogue_tiles_hgr_x2:
; tile empty (white)
        .byte $00, $00, $00, $00, $00, $00, $00, $00
        .byte $00, $00, $00, $00, $00, $00, $00, $00
        .byte $00, $00, $00, $00, $00, $00, $00, $00
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        .byte $00, $00, $00, $00, $00, $00, $00, $00
; tile wall (white)
        .byte $73, $7F, $4F, $7F, $73, $7F, $4F, $7F
        .byte $73, $7F, $4F, $7F, $73, $7F, $4F, $7F
        .byte $73, $7F, $4F, $7F, $73, $7F, $4F, $7F
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        .byte $73, $7F, $4F, $7F, $73, $7F, $4F, $7F
; tile stairs_down (green)
        .byte $00, $00, $00, $00, $00, $00, $00, $00
        .byte $2A, $55, $2A, $55, $2A, $55, $2A, $55
        .byte $02, $00, $00, $40, $02, $00, $00, $40
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        .byte $00, $00, $00, $00, $00, $00, $00, $00
; tile door (orange)
        .byte $00, $00, $00, $00, $00, $00, $00, $00
        .byte $00, $D1, $8A, $81, $00, $D1, $8A, $81
        .byte $A8, $D1, $8A, $95, $A8, $D1, $8A, $95
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        .byte $00, $00, $00, $00, $00, $00, $00, $00
; tile stairs_up (white)
        .byte $73, $7F, $70, $1F, $73, $7F, $70, $1F
        .byte $7C, $7F, $73, $1F, $7C, $7F, $73, $1F
        .byte $7F, $7F, $7F, $1F, $7F, $7F, $7F, $1F
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        .byte $03, $00, $70, $1F, $03, $00, $70, $1F
; tile trap_pit (violet)
        .byte $00, $00, $00, $00, $00, $00, $00, $00
        .byte $54, $2A, $55, $0A, $54, $2A, $55, $0A
        .byte $05, $00, $00, $28, $05, $00, $00, $28
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        .byte $00, $00, $00, $00, $00, $00, $00, $00
; tile gold (orange)
        .byte $00, $00, $00, $00, $00, $00, $00, $00
        .byte $00, $00, $00, $00, $00, $00, $00, $00
        .byte $00, $D5, $82, $00, $00, $D5, $82, $00
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        .byte $00, $00, $00, $00, $00, $00, $00, $00
; tile potion (violet)
        .byte $00, $00, $00, $00, $00, $00, $00, $00
        .byte $00, $00, $00, $00, $00, $00, $00, $00
        .byte $00, $00, $00, $00, $00, $00, $00, $00
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        .byte $00, $00, $00, $00, $00, $00, $00, $00

; --- x2 sprites: 14 x (32 rows x 4 bytes), offset = slot*32 ------------
rogue_sprites_hgr_x2:
char_guard_hgr_x2:                  ; slot 0 (blue)
        .byte $00, $A0, $81, $A0, $00, $A0, $81, $A0
        .byte $00, $AA, $95, $A8, $00, $AA, $95, $A8
        .byte $C0, $AA, $D5, $00, $C0, $AA, $D5, $00
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        .byte $00, $00, $00, $00, $00, $00, $00, $00
undead_zombie_hgr_x2:                  ; slot 4 (green)
        .byte $00, $00, $00, $00, $00, $00, $00, $00
        .byte $00, $00, $00, $40, $00, $00, $00, $40
        .byte $20, $54, $2A, $00, $20, $54, $2A, $00
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        .byte $00, $10, $08, $01, $00, $10, $08, $01
undead_ghost_hgr_x2:                  ; slot 8 (violet)
        .byte $00, $00, $00, $00, $00, $00, $00, $00
        .byte $00, $2A, $15, $00, $00, $2A, $15, $00
        .byte $40, $2A, $55, $00, $40, $2A, $55, $00
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        .byte $00, $00, $00, $00, $00, $00, $00, $00
undead_reaper_hgr_x2:                  ; slot 12 (orange)
        .byte $00, $00, $00, $00, $00, $00, $00, $00
        .byte $8A, $D0, $AA, $81, $8A, $D0, $AA, $81
        .byte $AA, $D4, $AA, $00, $AA, $D4, $AA, $00
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        .byte $82, $85, $8A, $85, $82, $85, $8A, $85
food_meat_hgr_x2:                  ; slot 16 (green)
        .byte $00, $00, $00, $00, $00, $00, $00, $00
        .byte $00, $00, $00, $05, $00, $00, $00, $05
        .byte $00, $00, $00, $55, $00, $00, $00, $55
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        .byte $00, $00, $00, $00, $00, $00, $00, $00
undead_skeleton_hgr_x2:                  ; slot 20 (white)
        .byte $00, $00, $00, $00, $00, $00, $00, $00
        .byte $00, $7E, $3F, $00, $00, $7E, $3F, $00
        .byte $40, $7F, $7F, $01, $40, $7F, $7F, $01
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        .byte $00, $00, $00, $00, $00, $00, $00, $00
item_dagger_hgr_x2:                  ; slot 24 (white)
        .byte $00, $00, $00, $00, $00, $00, $00, $00
        .byte $00, $00, $00, $00, $00, $00, $00, $00
        .byte $00, $00, $00, $00, $00, $00, $00, $00
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        .byte $00, $00, $00, $00, $00, $00, $00, $00
item_potion_hgr_x2:                  ; slot 28 (violet)
        .byte $00, $00, $00, $00, $00, $00, $00, $00
        .byte $00, $00, $00, $00, $00, $00, $00, $00
        .byte $00, $00, $00, $00, $00, $00, $00, $00
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        .byte $00, $00, $00, $00, $00, $00, $00, $00
item_scroll_hgr_x2:                  ; slot 32 (white)
        .byte $00, $00, $00, $00, $00, $00, $00, $00
        .byte $00, $7E, $7F, $1F, $00, $7E, $7F, $1F
        .byte $40, $61, $7F, $7F, $40, $61, $7F, $7F
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        .byte $00, $00, $00, $00, $00, $00, $00, $00
item_weapon_hgr_x2:                  ; slot 36 (blue)
        .byte $00, $00, $00, $00, $00, $00, $00, $00
        .byte $00, $00, $C0, $AA, $00, $00, $C0, $AA
        .byte $00, $00, $D0, $AA, $00, $00, $D0, $AA
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        .byte $00, $00, $00, $00, $00, $00, $00, $00
item_armor_hgr_x2:                  ; slot 40 (orange)
        .byte $00, $00, $00, $00, $00, $00, $00, $00
        .byte $00, $00, $00, $00, $00, $00, $00, $00
        .byte $00, $00, $00, $00, $00, $00, $00, $00
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        .byte $00, $00, $00, $00, $00, $00, $00, $00
item_ring_hgr_x2:                  ; slot 44 (orange)
        .byte $00, $00, $00, $00, $00, $00, $00, $00
        .byte $00, $00, $00, $00, $00, $00, $00, $00
        .byte $00, $00, $00, $00, $00, $00, $00, $00
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        .byte $00, $00, $00, $00, $00, $00, $00, $00
troll_goblin_hgr_x2:                  ; slot 48 (green)
        .byte $00, $00, $00, $00, $00, $00, $00, $00
        .byte $00, $00, $00, $00, $00, $00, $00, $00
        .byte $00, $00, $00, $00, $00, $00, $00, $00
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        .byte $00, $10, $08, $00, $00, $10, $08, $00
expl_torch_hgr_x2:                  ; slot 52 (orange)
        .byte $00, $00, $00, $00, $00, $00, $00, $00
        .byte $00, $00, $88, $00, $00, $00, $88, $00
        .byte $00, $00, $A8, $84, $00, $00, $A8, $84
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        .byte $00, $00, $00, $00, $00, $00, $00, $00

; --- x2 boss: two column halves, 64 rows x 4 bytes each ----------------
boss_hgr_x2_l:                 ; left 28 px (orange)
        .byte $00, $00, $00, $00, $00, $00, $00, $00
        .byte $00, $D0, $00, $00, $00, $D0, $00, $00
        .byte $00, $94, $00, $00, $00, $94, $00, $00
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        .byte $00, $00, $00, $00, $00, $00, $00, $00
boss_hgr_x2_r:                 ; right 28 px
        .byte $00, $00, $00, $00, $00, $00, $00, $00
        .byte $00, $C0, $82, $00, $00, $C0, $82, $00
        .byte $00, $00, $8A, $00, $00, $00, $8A, $00
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        .byte $00, $00, $00, $00, $00, $00, $00, $00
