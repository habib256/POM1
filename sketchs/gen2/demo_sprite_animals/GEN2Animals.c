/*
 * GEN2Animals.c — HGR equivalent of the TMS9918 demo_sprite_animals, on
 *                 Uncle Bernie's GEN2 Color Graphics Card (cc65 / gen2c).
 *
 *   GEN2 Fauna (8 HGR x2 colour sprites, 2px-smooth) / VERHILLE Arnaud 2026
 *
 * EIGHT SCROLL-O-SPRITES "Fauna" silhouettes as HGR x2 COLOUR sprites (one hue
 * each, source pixels doubled to span a full NTSC colour clock):
 *   dog=WHITE octopus=BLUE bat=GREEN lion=ORANGE
 *   rabbit=VIOLET spider=ORANGE cat=BLUE snake=GREEN
 *
 * SMOOTH 2px MOTION via 7 pre-shifted phases per animal (even shifts keep the
 * NTSC parity so the hue survives), baked OFFLINE by gen_x2.py. Runtime picks
 * phase (x%14)/2 at byte column 2*(x/14). Vertical is 1px-smooth.
 *
 * PERFORMANCE (per-frame budget is dominated by the 16 sprite blits):
 *   - INCREMENTAL: captions drawn once/page; each frame only touches sprite
 *     footprints. ERASE is a byte-column 0-FILL (gen2_hgr_fill_rect) of the
 *     footprint rectangle, NOT a CLEAR-blit of the shape: on a black field the
 *     fill's tight STA loop (no source read, no per-byte AND) is ~2x cheaper, and
 *     needs no bank/phase data. DRAW is a GEN2_SET blit (OR keeps overlaps).
 *   - BOUNDING-BOX TRIM, per-phase: each phase is baked to its OWN content box
 *     (yoff/rows + per-phase xoff/width, ~4-5 bytes not 7) — blit7 pays for zero
 *     bytes too. ~40% fewer byte-ops AND small enough (7.1 KB) to fit 8 sprites'
 *     banks even when the DevBench force-links the whole gen2c runtime.
 *   - ZERO per-frame mul/div: sine pre-scaled per amplitude + phase accumulators;
 *     x->(base,phase,bank offset) is a boot-built LUT (parked in LOWBSS).
 *   - Double-buffered (flip in V-blank -> no tear).
 *
 * Self-contained (the in-app DevBench compiles a single file); banks are baked,
 * so no runtime x2 inflate. ESC -> Wozmon; apple1_readkey is non-blocking.
 *
 *   Build : make   Run : POM1 --preset 11 --load 6000:GEN2Animals.bin --run 6000
 */
#include "gen2.h"
#include "apple1io.h"

#define NA   8u                       /* 8 fauna animals                        */

/* ===== 7-phase pre-shifted x2 colour banks (TRIMMED per phase), by gen_x2.py = */
/* dog -> x2 WHITE, 7 phases (2px), TRIMMED to 24 rows x per-phase width [5, 5, 5, 5, 5, 5, 4]: 816 B */
#define DOG_YOFF 8u
#define DOG_ROWS 24u
static const unsigned char dog_xoff[7] = { 0u,0u,0u,1u,1u,1u,2u };
static const unsigned char dog_wp[7]   = { 5u,5u,5u,5u,5u,5u,4u };
static const unsigned char x2ps_dog[816] = {
    /* phase 0: shift 0px, xoff 0, w 5 */
    0x40,0x07,0x70,0x01,0x00,
    0x40,0x07,0x70,0x01,0x00,
    0x40,0x07,0x70,0x01,0x00,
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    0x00,0x66,0x3F,0x1E,0x00,
    /* phase 1: shift 2px, xoff 0, w 5 */
    0x00,0x1E,0x40,0x07,0x00,
    0x00,0x1E,0x40,0x07,0x00,
    0x00,0x1E,0x40,0x07,0x00,
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    0x00,0x18,0x7F,0x79,0x00,
    /* phase 2: shift 4px, xoff 0, w 5 */
    0x00,0x78,0x00,0x1E,0x00,
    0x00,0x78,0x00,0x1E,0x00,
    0x00,0x78,0x00,0x1E,0x00,
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    0x00,0x60,0x7C,0x67,0x03,
    /* phase 3: shift 6px, xoff 1, w 5 */
    0x60,0x03,0x78,0x00,0x00,
    0x60,0x03,0x78,0x00,0x00,
    0x60,0x03,0x78,0x00,0x00,
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    0x00,0x73,0x1F,0x0F,0x00,
    /* phase 4: shift 8px, xoff 1, w 5 */
    0x00,0x0F,0x60,0x03,0x00,
    0x00,0x0F,0x60,0x03,0x00,
    0x00,0x0F,0x60,0x03,0x00,
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    0x00,0x4C,0x7F,0x3C,0x00,
    /* phase 5: shift 10px, xoff 1, w 5 */
    0x00,0x3C,0x00,0x0F,0x00,
    0x00,0x3C,0x00,0x0F,0x00,
    0x00,0x3C,0x00,0x0F,0x00,
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    0x00,0x30,0x7E,0x73,0x01,
    /* phase 6: shift 12px, xoff 2, w 4 */
    0x70,0x01,0x3C,0x00,
    0x70,0x01,0x3C,0x00,
    0x70,0x01,0x3C,0x00,
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    0x40,0x79,0x4F,0x07,
};

/* octopus -> x2 BLUE, 7 phases (2px), TRIMMED to 30 rows x per-phase width [5, 5, 5, 4, 5, 5, 4]: 990 B */
#define OCTOPUS_YOFF 2u
#define OCTOPUS_ROWS 30u
static const unsigned char octopus_xoff[7] = { 0u,0u,0u,1u,1u,1u,2u };
static const unsigned char octopus_wp[7]   = { 5u,5u,5u,4u,5u,5u,4u };
static const unsigned char x2ps_octopus[990] = {
    /* phase 0: shift 0px, xoff 0, w 5 */
    0xC0,0xA0,0x95,0x88,0x00,
    0xC0,0xA0,0x95,0x88,0x00,
    0xC0,0xA8,0xD5,0x88,0x00,
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    0x00,0x82,0x00,0x82,0x00,
    /* phase 1: shift 2px, xoff 0, w 5 */
    0x00,0x82,0xD5,0xA0,0x00,
    0x00,0x82,0xD5,0xA0,0x00,
    0x00,0xA2,0xD5,0xA2,0x00,
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    0x00,0x88,0x00,0x88,0x00,
    /* phase 2: shift 4px, xoff 0, w 5 */
    0x00,0x88,0xD4,0x82,0x81,
    0x00,0x88,0xD4,0x82,0x81,
    0x00,0x88,0xD5,0x8A,0x81,
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    0x00,0xA0,0x00,0xA0,0x00,
    /* phase 3: shift 6px, xoff 1, w 4 */
    0xA0,0xD0,0x8A,0x84,
    0xA0,0xD0,0x8A,0x84,
    0xA0,0xD4,0xAA,0x84,
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    0x00,0x81,0x00,0x81,
    /* phase 4: shift 8px, xoff 1, w 5 */
    0x00,0xC1,0xAA,0x90,0x00,
    0x00,0xC1,0xAA,0x90,0x00,
    0x00,0xD1,0xAA,0x91,0x00,
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    0x00,0x84,0x00,0x84,0x00,
    /* phase 5: shift 10px, xoff 1, w 5 */
    0x00,0x84,0xAA,0xC1,0x00,
    0x00,0x84,0xAA,0xC1,0x00,
    0x00,0xC4,0xAA,0xC5,0x00,
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    0x00,0x90,0x00,0x90,0x00,
    /* phase 6: shift 12px, xoff 2, w 4 */
    0x90,0xA8,0x85,0x82,
    0x90,0xA8,0x85,0x82,
    0x90,0xAA,0x95,0x82,
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    0xC0,0x00,0xC0,0x00,
};

/* bat -> x2 GREEN, 7 phases (2px), TRIMMED to 30 rows x per-phase width [5, 5, 4, 5, 5, 5, 4]: 990 B */
#define BAT_YOFF 2u
#define BAT_ROWS 30u
static const unsigned char bat_xoff[7] = { 0u,0u,1u,1u,1u,1u,2u };
static const unsigned char bat_wp[7]   = { 5u,5u,4u,5u,5u,5u,4u };
static const unsigned char x2ps_bat[990] = {
    /* phase 0: shift 0px, xoff 0, w 5 */
    0x00,0x00,0x08,0x00,0x00,
    0x00,0x00,0x08,0x00,0x00,
    0x00,0x54,0x0A,0x00,0x00,
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    0x00,0x40,0x2A,0x00,0x00,
    /* phase 1: shift 2px, xoff 0, w 5 */
    0x00,0x00,0x20,0x00,0x00,
    0x00,0x00,0x20,0x00,0x00,
    0x00,0x50,0x2A,0x00,0x00,
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    0x00,0x00,0x2A,0x01,0x00,
    /* phase 2: shift 4px, xoff 1, w 4 */
    0x00,0x00,0x01,0x00,
    0x00,0x00,0x01,0x00,
    0x40,0x2A,0x01,0x00,
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    0x00,0x28,0x05,0x00,
    /* phase 3: shift 6px, xoff 1, w 5 */
    0x00,0x00,0x04,0x00,0x00,
    0x00,0x00,0x04,0x00,0x00,
    0x00,0x2A,0x05,0x00,0x00,
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    0x00,0x20,0x15,0x00,0x00,
    /* phase 4: shift 8px, xoff 1, w 5 */
    0x00,0x00,0x10,0x00,0x00,
    0x00,0x00,0x10,0x00,0x00,
    0x00,0x28,0x15,0x00,0x00,
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    0x00,0x00,0x55,0x00,0x00,
    /* phase 5: shift 10px, xoff 1, w 5 */
    0x00,0x00,0x40,0x00,0x00,
    0x00,0x00,0x40,0x00,0x00,
    0x00,0x20,0x55,0x00,0x00,
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    0x00,0x00,0x54,0x02,0x00,
    /* phase 6: shift 12px, xoff 2, w 4 */
    0x00,0x00,0x02,0x00,
    0x00,0x00,0x02,0x00,
    0x00,0x55,0x02,0x00,
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    0x00,0x50,0x0A,0x00,
};

/* lion -> x2 ORANGE, 7 phases (2px), TRIMMED to 30 rows x per-phase width [5, 5, 5, 5, 5, 5, 5]: 1050 B */
#define LION_YOFF 2u
#define LION_ROWS 30u
static const unsigned char lion_xoff[7] = { 0u,0u,1u,1u,1u,1u,2u };
static const unsigned char lion_wp[7]   = { 5u,5u,5u,5u,5u,5u,5u };
static const unsigned char x2ps_lion[1050] = {
    /* phase 0: shift 0px, xoff 0, w 5 */
    0x00,0x00,0x8A,0x81,0x00,
    0x00,0x00,0x8A,0x81,0x00,
    0x00,0xD0,0xAA,0x85,0x00,
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    0x88,0x84,0x00,0x91,0x82,
    /* phase 1: shift 2px, xoff 0, w 5 */
    0x00,0x00,0xA8,0x84,0x00,
    0x00,0x00,0xA8,0x84,0x00,
    0x00,0xC0,0xAA,0x95,0x00,
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    0xA0,0x90,0x00,0xC4,0x88,
    /* phase 2: shift 4px, xoff 1, w 5 */
    0x00,0xA0,0x91,0x00,0x00,
    0x00,0xA0,0x91,0x00,0x00,
    0x00,0xAA,0xD5,0x00,0x00,
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    0xC1,0x00,0x90,0xA2,0x00,
    /* phase 3: shift 6px, xoff 1, w 5 */
    0x00,0x00,0xC5,0x00,0x00,
    0x00,0x00,0xC5,0x00,0x00,
    0x00,0xA8,0xD5,0x82,0x00,
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    0x84,0x82,0xC0,0x88,0x81,
    /* phase 4: shift 8px, xoff 1, w 5 */
    0x00,0x00,0x94,0x82,0x00,
    0x00,0x00,0x94,0x82,0x00,
    0x00,0xA0,0xD5,0x8A,0x00,
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    0x90,0x88,0x00,0xA2,0x84,
    /* phase 5: shift 10px, xoff 1, w 5 */
    0x00,0x00,0xD0,0x88,0x00,
    0x00,0x00,0xD0,0x88,0x00,
    0x00,0x00,0xD5,0xAA,0x00,
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    0xC0,0xA0,0x00,0x88,0x91,
    /* phase 6: shift 12px, xoff 2, w 5 */
    0x00,0xC0,0xA2,0x00,0x00,
    0x00,0xC0,0xA2,0x00,0x00,
    0x00,0xD4,0xAA,0x81,0x00,
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    0x82,0x81,0xA0,0xC4,0x00,
};

/* rabbit -> x2 VIOLET, 7 phases (2px), TRIMMED to 20 rows x per-phase width [5, 5, 5, 4, 5, 5, 4]: 660 B */
#define RABBIT_YOFF 6u
#define RABBIT_ROWS 20u
static const unsigned char rabbit_xoff[7] = { 0u,0u,0u,1u,1u,1u,2u };
static const unsigned char rabbit_wp[7]   = { 5u,5u,5u,4u,5u,5u,4u };
static const unsigned char x2ps_rabbit[660] = {
    /* phase 0: shift 0px, xoff 0, w 5 */
    0x40,0x00,0x00,0x08,0x00,
    0x40,0x00,0x00,0x08,0x00,
    0x10,0x08,0x40,0x20,0x00,
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    0x04,0x00,0x00,0x00,0x01,
    /* phase 1: shift 2px, xoff 0, w 5 */
    0x00,0x02,0x00,0x20,0x00,
    0x00,0x02,0x00,0x20,0x00,
    0x40,0x20,0x00,0x02,0x01,
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    0x10,0x00,0x00,0x00,0x04,
    /* phase 2: shift 4px, xoff 0, w 5 */
    0x00,0x08,0x00,0x00,0x01,
    0x00,0x08,0x00,0x00,0x01,
    0x00,0x02,0x01,0x08,0x04,
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    0x40,0x00,0x00,0x00,0x10,
    /* phase 3: shift 6px, xoff 1, w 4 */
    0x20,0x00,0x00,0x04,
    0x20,0x00,0x00,0x04,
    0x08,0x04,0x20,0x10,
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    0x02,0x00,0x00,0x40,
    /* phase 4: shift 8px, xoff 1, w 5 */
    0x00,0x01,0x00,0x10,0x00,
    0x00,0x01,0x00,0x10,0x00,
    0x20,0x10,0x00,0x41,0x00,
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    0x08,0x00,0x00,0x00,0x02,
    /* phase 5: shift 10px, xoff 1, w 5 */
    0x00,0x04,0x00,0x40,0x00,
    0x00,0x04,0x00,0x40,0x00,
    0x00,0x41,0x00,0x04,0x02,
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    0x20,0x00,0x00,0x00,0x08,
    /* phase 6: shift 12px, xoff 2, w 4 */
    0x10,0x00,0x00,0x02,
    0x10,0x00,0x00,0x02,
    0x04,0x02,0x10,0x08,
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    0x01,0x00,0x00,0x20,
};

/* spider -> x2 ORANGE, 7 phases (2px), TRIMMED to 28 rows x per-phase width [4, 4, 4, 4, 5, 4, 4]: 812 B */
#define SPIDER_YOFF 2u
#define SPIDER_ROWS 28u
static const unsigned char spider_xoff[7] = { 0u,1u,1u,1u,1u,2u,2u };
static const unsigned char spider_wp[7]   = { 4u,4u,4u,4u,5u,4u,4u };
static const unsigned char x2ps_spider[812] = {
    /* phase 0: shift 0px, xoff 0, w 4 */
    0x00,0xD5,0xA0,0x00,
    0x00,0xD5,0xA0,0x00,
    0x00,0xD5,0x8A,0x84,
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    0x00,0xC0,0xA8,0x95,
    /* phase 1: shift 2px, xoff 1, w 4 */
    0xD4,0x82,0x81,0x00,
    0xD4,0x82,0x81,0x00,
    0xD4,0xAA,0x90,0x00,
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    0x00,0xA2,0xD5,0x00,
    /* phase 2: shift 4px, xoff 1, w 4 */
    0xD0,0x8A,0x84,0x00,
    0xD0,0x8A,0x84,0x00,
    0xD0,0xAA,0xC1,0x00,
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    0x00,0x88,0xD5,0x82,
    /* phase 3: shift 6px, xoff 1, w 4 */
    0xC0,0xAA,0x90,0x00,
    0xC0,0xAA,0x90,0x00,
    0xC0,0xAA,0x85,0x82,
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    0x00,0xA0,0xD4,0x8A,
    /* phase 4: shift 8px, xoff 1, w 5 */
    0x00,0xAA,0xC1,0x00,0x00,
    0x00,0xAA,0xC1,0x00,0x00,
    0x00,0xAA,0x95,0x88,0x00,
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    0x00,0x00,0xD1,0xAA,0x00,
    /* phase 5: shift 10px, xoff 2, w 4 */
    0xA8,0x85,0x82,0x00,
    0xA8,0x85,0x82,0x00,
    0xA8,0xD5,0xA0,0x00,
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    0x00,0xC4,0xAA,0x81,
    /* phase 6: shift 12px, xoff 2, w 4 */
    0xA0,0x95,0x88,0x00,
    0xA0,0x95,0x88,0x00,
    0xA0,0xD5,0x82,0x81,
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    0x00,0x90,0xAA,0x85,
};

/* cat -> x2 BLUE, 7 phases (2px), TRIMMED to 30 rows x per-phase width [5, 5, 5, 4, 5, 5, 4]: 990 B */
#define CAT_YOFF 2u
#define CAT_ROWS 30u
static const unsigned char cat_xoff[7] = { 0u,0u,0u,1u,1u,1u,2u };
static const unsigned char cat_wp[7]   = { 5u,5u,5u,4u,5u,5u,4u };
static const unsigned char x2ps_cat[990] = {
    /* phase 0: shift 0px, xoff 0, w 5 */
    0x00,0xAA,0x00,0x00,0x00,
    0x00,0xAA,0x00,0x00,0x00,
    0xC0,0xAA,0x81,0x00,0x00,
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    0x90,0x82,0x00,0xA2,0x00,
    /* phase 1: shift 2px, xoff 0, w 5 */
    0x00,0xA8,0x81,0x00,0x00,
    0x00,0xA8,0x81,0x00,0x00,
    0x00,0xAA,0x85,0x00,0x00,
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    0xC0,0x88,0x00,0x88,0x81,
    /* phase 2: shift 4px, xoff 0, w 5 */
    0x00,0xA0,0x85,0x00,0x00,
    0x00,0xA0,0x85,0x00,0x00,
    0x00,0xA8,0x95,0x00,0x00,
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    0x00,0xA2,0x00,0xA0,0x84,
    /* phase 3: shift 6px, xoff 1, w 4 */
    0x00,0x95,0x00,0x00,
    0x00,0x95,0x00,0x00,
    0xA0,0xD5,0x00,0x00,
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    0x88,0x81,0x00,0x91,
    /* phase 4: shift 8px, xoff 1, w 5 */
    0x00,0xD4,0x00,0x00,0x00,
    0x00,0xD4,0x00,0x00,0x00,
    0x00,0xD5,0x82,0x00,0x00,
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    0xA0,0x84,0x00,0xC4,0x00,
    /* phase 5: shift 10px, xoff 1, w 5 */
    0x00,0xD0,0x82,0x00,0x00,
    0x00,0xD0,0x82,0x00,0x00,
    0x00,0xD4,0x8A,0x00,0x00,
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    0x00,0x91,0x00,0x90,0x82,
    /* phase 6: shift 12px, xoff 2, w 4 */
    0xC0,0x8A,0x00,0x00,
    0xC0,0x8A,0x00,0x00,
    0xD0,0xAA,0x00,0x00,
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    0xC4,0x00,0xC0,0x88,
};

/* snake -> x2 GREEN, 7 phases (2px), TRIMMED to 24 rows x per-phase width [5, 5, 4, 5, 5, 5, 4]: 792 B */
#define SNAKE_YOFF 8u
#define SNAKE_ROWS 24u
static const unsigned char snake_xoff[7] = { 0u,0u,1u,1u,1u,1u,2u };
static const unsigned char snake_wp[7]   = { 5u,5u,4u,5u,5u,5u,4u };
static const unsigned char x2ps_snake[792] = {
    /* phase 0: shift 0px, xoff 0, w 5 */
    0x00,0x40,0x2A,0x15,0x00,
    0x00,0x40,0x2A,0x15,0x00,
    0x00,0x50,0x2A,0x55,0x00,
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    0x08,0x11,0x28,0x55,0x00,
    /* phase 1: shift 2px, xoff 0, w 5 */
    0x00,0x00,0x2A,0x55,0x00,
    0x00,0x00,0x2A,0x55,0x00,
    0x00,0x40,0x2A,0x55,0x02,
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    0x20,0x44,0x20,0x55,0x02,
    /* phase 2: shift 4px, xoff 1, w 4 */
    0x00,0x28,0x55,0x02,
    0x00,0x28,0x55,0x02,
    0x00,0x2A,0x55,0x0A,
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    0x11,0x02,0x55,0x0A,
    /* phase 3: shift 6px, xoff 1, w 5 */
    0x00,0x20,0x55,0x0A,0x00,
    0x00,0x20,0x55,0x0A,0x00,
    0x00,0x28,0x55,0x2A,0x00,
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    0x44,0x08,0x54,0x2A,0x00,
    /* phase 4: shift 8px, xoff 1, w 5 */
    0x00,0x00,0x55,0x2A,0x00,
    0x00,0x00,0x55,0x2A,0x00,
    0x00,0x20,0x55,0x2A,0x01,
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    0x10,0x22,0x50,0x2A,0x01,
    /* phase 5: shift 10px, xoff 1, w 5 */
    0x00,0x00,0x54,0x2A,0x01,
    0x00,0x00,0x54,0x2A,0x01,
    0x00,0x00,0x55,0x2A,0x05,
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    0x40,0x08,0x41,0x2A,0x05,
    /* phase 6: shift 12px, xoff 2, w 4 */
    0x00,0x50,0x2A,0x05,
    0x00,0x50,0x2A,0x05,
    0x00,0x54,0x2A,0x15,
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    0x22,0x04,0x2A,0x15,
};


static const unsigned char *const spr[NA] = {
    x2ps_dog, x2ps_octopus, x2ps_bat, x2ps_lion,
    x2ps_rabbit, x2ps_spider, x2ps_cat, x2ps_snake
};
static const unsigned char sprYoff[NA] = {
    DOG_YOFF, OCTOPUS_YOFF, BAT_YOFF, LION_YOFF,
    RABBIT_YOFF, SPIDER_YOFF, CAT_YOFF, SNAKE_YOFF
};
static const unsigned char sprRows[NA] = {
    DOG_ROWS, OCTOPUS_ROWS, BAT_ROWS, LION_ROWS,
    RABBIT_ROWS, SPIDER_ROWS, CAT_ROWS, SNAKE_ROWS
};
static const unsigned char *const sprXoff[NA] = {
    dog_xoff, octopus_xoff, bat_xoff, lion_xoff,
    rabbit_xoff, spider_xoff, cat_xoff, snake_xoff
};
static const unsigned char *const sprWp[NA] = {   /* per-phase blit width (4/5)  */
    dog_wp, octopus_wp, bat_wp, lion_wp,
    rabbit_wp, spider_wp, cat_wp, snake_wp
};

/* sin(2*pi*i/32)*12 (used only to build the pre-scaled sX/sY tables). */
static const signed char sin32[32] = {
    0, 2, 5, 7, 8, 10, 11, 12, 12, 12, 11, 10, 8, 7, 5, 2,
    0, -2, -5, -7, -8, -10, -11, -12, -12, -12, -11, -10, -8, -7, -5, -2
};

/* 8 animals in a rough 4x2 grid, each with its own Lissajous params. clampi
 * keeps them on-screen; overlaps are fine (erase+redraw). home/amp are 8-bit to
 * save RODATA (x<=224, y<=150, amp<=32). */
static const unsigned char homeX[NA] = {  36u,  96u, 156u, 206u,  36u,  96u, 156u, 206u };
static const unsigned char homeY[NA] = {  36u,  42u,  34u,  40u, 110u, 104u, 112u, 106u };
static const unsigned char pmX[NA]   = {   1u,   2u,   3u,   1u,   2u,   3u,   1u,   2u };
static const unsigned char offX[NA]  = {   0u,   0u,   0u,   8u,   4u,  12u,   6u,   2u };
static const signed char   ampX[NA]  = {  30,   28,   26,   16,   30,   28,   26,   16 };
static const unsigned char pmY[NA]   = {   1u,   1u,   3u,   5u,   2u,   1u,   3u,   2u };
static const unsigned char offY[NA]  = {   8u,  17u,  11u,   3u,   5u,  20u,  14u,  25u };
static const signed char   ampY[NA]  = {  22,   28,   20,   26,   30,   28,   32,   26 };

/* These runtime tables are UNINITIALISED (init_luts / set_pos fill them before
 * first read), so park them in LOWBSS ($0C00-$1FFF, idle below the framebuffers)
 * instead of the tight $6000-$BEFF BSS. That's what keeps 8 sprites fitting when
 * the in-app DevBench force-links the WHOLE gen2c runtime. crt0 does NOT zero
 * LOWBSS, which is fine: nothing here is read before it is written. See
 * [[gen2c_devbench_forcelink_lowbss]]. */
#define NX2 113u
#pragma bss-name(push, "LOWBSS")
static int cx[NA], cy[NA];
static signed char  sX[NA][32], sY[NA][32];   /* sine pre-scaled by amplitude    */
static unsigned char phX[NA], phY[NA];        /* phase accumulators              */
static unsigned char baseT[NX2];              /* base pixel   = (h/7)*14         */
static unsigned char baseCol[NX2];            /* base byte col = (h/7)*2 (erase) */
static unsigned char phTb[NX2];               /* phase = h%7 (0..6)              */
static unsigned char xoff7[NA][7];            /* per-phase content xoff * 7 (px) */
static unsigned      bankOff[NA][7];          /* per-phase bank byte offset (cum)*/
#pragma bss-name(pop)

static int clampi(int v, int lo, int hi) {
    if (v < lo) return lo;
    if (v > hi) return hi;
    return v;
}

static void init_luts(void) {
    unsigned char i, p, h, ph, nr;
    unsigned off;
    for (i = 0u; i < NA; ++i) {
        phX[i] = offX[i];
        phY[i] = offY[i];
        for (p = 0u; p < 32u; ++p) {
            sX[i][p] = (signed char)((int)sin32[p] * ampX[i] / 12);
            sY[i][p] = (signed char)((int)sin32[p] * ampY[i] / 12);
        }
        nr = sprRows[i];
        off = 0u;                          /* cumulative bank offset (phases vary) */
        for (ph = 0u; ph < 7u; ++ph) {
            xoff7[i][ph]   = (unsigned char)(sprXoff[i][ph] * 7u);
            bankOff[i][ph] = off;
            off += (unsigned)nr * sprWp[i][ph];
        }
    }
    for (h = 0u; h < NX2; ++h) {
        unsigned char q = (unsigned char)(h / 7u);
        baseT[h]   = (unsigned char)(q * 14u);   /* pixel of the 14-aligned base */
        baseCol[h] = (unsigned char)(q * 2u);    /* its byte column (= pixel/7)  */
        phTb[h]    = (unsigned char)(h % 7u);
    }
}

static void set_pos(void) {
    unsigned char i;
    for (i = 0u; i < NA; ++i) {
        cx[i] = clampi((int)homeX[i] + sX[i][phX[i] & 31u], 0, 224);
        cy[i] = clampi((int)homeY[i] + sY[i][phY[i] & 31u], 14, 150);
        phX[i] = (unsigned char)(phX[i] + pmX[i]);
        phY[i] = (unsigned char)(phY[i] + pmY[i]);
    }
}

/* DRAW: OR the sprite's trimmed sub-image (SET keeps overlaps additive). */
static void draw_animal(unsigned char id, int x, int y) {
    unsigned char h  = (unsigned char)((unsigned)x >> 1);
    unsigned char ph = phTb[h];
    gen2_hgr_blit7((unsigned)baseT[h] + xoff7[id][ph],
                   (unsigned char)(y + sprYoff[id]),
                   sprWp[id][ph], sprRows[id], spr[id] + bankOff[id][ph], GEN2_SET);
}

/* ERASE: on a black field, clearing the footprint is a byte-column 0-FILL, not
 * a CLEAR-blit of the shape. gen2_hgr_fill_rect's inner loop is a tight STA (no
 * source read, no per-byte AND/EOR) -> ~2x cheaper than GEN2_CLEAR, and the erase
 * needs no bank/phase data — just the same rectangle the draw covered. */
static void erase_animal(unsigned char id, int x, int y) {
    unsigned char h  = (unsigned char)((unsigned)x >> 1);
    unsigned char ph = phTb[h];
    gen2_hgr_fill_rect((unsigned char)(y + sprYoff[id]), sprRows[id],
                       (unsigned char)(baseCol[h] + sprXoff[id][ph]),
                       sprWp[id][ph], 0u);
}

void main(void) {
    unsigned char page = 1u, pidx, i, pg;
    int ox[NA][2], oy[NA][2];

    gen2_hgr_init();
    init_luts();

    for (pg = 1u; pg <= 2u; ++pg) {
        gen2_set_draw_page(pg);
        gen2_hgr_clear(0u);
        gen2_hgr_puts8(4u, 4u, "FAUNA - HGR X2 (8 SPRITES)");
        gen2_hgr_puts8(4u, 184u, "DOG OCT BAT LION RAB SPI CAT SNK  ESC");
    }

    set_pos();
    for (i = 0u; i < NA; ++i) { ox[i][0] = ox[i][1] = cx[i]; oy[i][0] = oy[i][1] = cy[i]; }

    for (;;) {
        pidx = (unsigned char)(page - 1u);
        gen2_set_draw_page(page);

        for (i = 0u; i < NA; ++i)                 /* erase old footprints (0-fill) */
            erase_animal(i, ox[i][pidx], oy[i][pidx]);
        for (i = 0u; i < NA; ++i) {               /* draw new positions            */
            draw_animal(i, cx[i], cy[i]);
            ox[i][pidx] = cx[i];
            oy[i][pidx] = cy[i];
        }

        gen2_wait_vbl();
        gen2_show_page();
        page = (page == 1u) ? 2u : 1u;

        set_pos();
        if (apple1_readkey() == 27u) woz_mon();
    }
}
