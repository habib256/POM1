; =============================================
; sokoban_levels_ext.inc - RLE-compressed levels 46..72
; Auto-generated by tools/sokoban_rle.py. Do not edit.
; Format identical to sokoban_levels.inc. HGR variant only.
; =============================================

; level46  9x9  raw=81B  rle=51B  (save 30B)
level46:
        .byte 9,9,1,5
        .byte $85,' ',$84,'#',$85,' ','#',' ','@','#',$85,' '
        .byte '#',$82,' ',$87,'#',' ','.',$82,'#',$83,' ','$'
        .byte $82,' ','.',$82,'#',$82,' ',$82,'$','#',' ','.'
        .byte $82,'#',$84,' ',$87,'#',$82,' ','#',$85,' ',$84
        .byte '#',$83,' '

; level47  5x3  raw=15B  rle=7B  (save 8B)
level47:
        .byte 5,3,4,7
        .byte $86,'#','@','$','.',$86,'#'

; level48  6x7  raw=42B  rle=30B  (save 12B)
level48:
        .byte 6,7,2,7
        .byte $87,'#',$83,'.',' ',$82,'#',$82,' ','$',' ',$82
        .byte '#',' ','#','$',$83,'#',$82,' ','$',' ',$82,'#'
        .byte $82,' ','@',' ',$87,'#'

; level49  7x8  raw=56B  rle=43B  (save 13B)
level49:
        .byte 7,8,2,6
        .byte ' ',$88,'#',$84,' ',$82,'#',$82,' ',$82,'#',' '
        .byte $82,'#',' ','#',' ','$',' ',$82,'#',$82,' ','*'
        .byte ' ','.',$83,'#',' ','#','@',$82,'#',' ','#',$83
        .byte ' ','#',$82,' ',$85,'#',' '

; level50  11x7  raw=77B  rle=51B  (save 26B)
level50:
        .byte 11,7,2,4
        .byte $82,' ',$87,'#',$82,' ',$83,'#',$85,' ','#',$82
        .byte ' ','#',' ','$',' ','$',$83,' ','#',$82,' ','#'
        .byte ' ',$83,'#',' ',$86,'#',' ','@',' ','.',' ','.'
        .byte $83,' ',$82,'#',$83,' ',$83,'#',$83,' ',$86,'#'
        .byte ' ',$85,'#'

; level51  8x8  raw=64B  rle=49B  (save 15B)
level51:
        .byte 8,8,2,6
        .byte $86,'#',$82,' ','#',$82,' ','@',' ','#',$82,' '
        .byte '#',$82,' ','#',' ',$82,'#',' ','#',' ','.','#'
        .byte $82,' ',$83,'#',' ','.',$83,'$',' ',$82,'#',' '
        .byte '.','#',$83,' ',$85,'#',$83,' ','#',$83,' ',$85
        .byte '#'

; level52  8x10  raw=80B  rle=64B  (save 16B)
level52:
        .byte 8,10,1,6
        .byte $86,'#',$82,' ','#',' ','@',$82,' ','#',$82,' '
        .byte '#',' ','$','#',' ','#',$82,' ','#',' ','$',$82
        .byte ' ','#',$82,' ','#',' ','$',' ',$82,'#',$82,' '
        .byte $83,'#',' ',$84,'#',' ','#',$82,' ','#',$82,' '
        .byte '#',' ','#',$83,'.',$82,' ','#',' ','#',$85,' '
        .byte '#',' ',$87,'#'

; level53  10x7  raw=70B  rle=45B  (save 25B)
level53:
        .byte 10,7,2,5
        .byte $82,' ',$84,'#',$84,' ',$83,'#',$82,' ',$86,'#'
        .byte $82,' ','$',$82,' ','@',$82,'.',$82,'#',' ','$'
        .byte $84,' ','#',' ',$84,'#',' ',$84,'#',' ','#',$82
        .byte ' ','#',$86,' ','#',$82,' ',$88,'#'

; level54  8x7  raw=56B  rle=39B  (save 17B)
level54:
        .byte 8,7,2,6
        .byte $84,'#',$84,' ','#',$82,' ',$83,'#',$82,' ','#'
        .byte $84,' ',$84,'#',$82,' ','$','*','@',' ',$84,'#'
        .byte ' ','.','#',' ','#',$82,' ','#',$84,' ','#',$82
        .byte ' ',$86,'#'

; level55  6x8  raw=48B  rle=39B  (save 9B)
level55:
        .byte 6,8,2,7
        .byte $82,' ',$87,'#',' ','@',$82,'#',$82,' ','$',' '
        .byte $82,'#',$82,' ','*','.',$82,'#',$82,' ','*','.'
        .byte $82,'#',$82,' ','$',' ',$84,'#',$82,' ','#',$82
        .byte ' ',$84,'#'

; level56  7x7  raw=49B  rle=41B  (save 8B)
level56:
        .byte 7,7,2,6
        .byte ' ',$85,'#',' ',$82,'#','.',' ','.',$83,'#',' '
        .byte '*',' ','*',' ',$82,'#',$82,' ','#',$82,' ',$82
        .byte '#',' ','$',' ','$',' ',$83,'#',' ','@',' ',$82
        .byte '#',' ',$85,'#',' '

; level57  12x8  raw=96B  rle=63B  (save 33B)
level57:
        .byte 12,8,2,4
        .byte $86,' ',$86,'#',$86,' ','#',$84,' ','#',$82,' '
        .byte $85,'#',' ','.',$82,' ',$84,'#',$82,' ',$83,'#'
        .byte '.',$82,' ',$82,'#',' ','$',$82,' ','$',$82,' '
        .byte '.',' ',$83,'#',' ','@',$82,'$',' ','#',' ','.'
        .byte ' ','#',' ',$82,'#',$84,' ',$85,'#',$82,' ',$86
        .byte '#',$85,' '

; level58  10x8  raw=80B  rle=57B  (save 23B)
level58:
        .byte 10,8,2,5
        .byte $88,'#',$82,' ','#',' ','@',' ','#',$82,' ','#'
        .byte $82,' ','#',$86,' ','#',$82,' ',$85,'#','$',' '
        .byte '#',$86,' ','#',$82,' ',$83,'#',' ',$82,'#',' '
        .byte '#','$',' ',$82,'.','#',' ',$82,'#',' ','#',$82
        .byte ' ',$83,'#',$84,' ',$84,'#',$82,' '

; level59  7x6  raw=42B  rle=30B  (save 12B)
level59:
        .byte 7,6,3,6
        .byte $85,'#',$82,' ','#',$83,' ',$84,'#',$82,' ','$'
        .byte $82,' ',$83,'#','*',' ','.',' ','#',' ','#',$83
        .byte ' ','@','#',' ',$86,'#'

; level60  8x9  raw=72B  rle=49B  (save 23B)
level60:
        .byte 8,9,1,6
        .byte $82,' ',$84,'#',$84,' ','#',$82,' ','#',$84,' '
        .byte '#','@',' ','#',$84,' ','#',$82,' ','#',$82,' '
        .byte $83,'#',' ',$85,'#',$84,' ','*',' ',$82,'#',$82
        .byte ' ','$',$83,' ',$86,'#','.',' ','#',$84,' ',$84
        .byte '#'

; level61  7x7  raw=49B  rle=38B  (save 11B)
level61:
        .byte 7,7,2,6
        .byte $84,'#',$83,' ','#',$82,' ',$85,'#','.','*','$'
        .byte $82,' ',$82,'#',' ','.','$','#',' ',$83,'#',' '
        .byte '@',$82,' ','#',' ','#',$83,' ',$82,'#',' ',$85
        .byte '#',' '

; level62  13x9  raw=117B  rle=66B  (save 51B)
level62:
        .byte 13,9,1,3
        .byte $8C,'#',' ','#',$8A,' ','#',' ','#',' ',$87,'#'
        .byte ' ','@',$83,'#',' ','#',$89,' ',$82,'#',' ','#'
        .byte $82,' ','$',$83,' ','#',$82,' ',$82,'#',' ',$82
        .byte '$',' ',$85,'#',$82,' ',$84,'#',$82,' ','#',' '
        .byte '#',' ',$83,'.','#',$82,' ',$84,'#',' ','#',$84
        .byte ' ','#',$87,' ',$86,'#'

; level63  10x10  raw=100B  rle=70B  (save 30B)
level63:
        .byte 10,10,1,5
        .byte ' ',$89,'#',' ','#',$87,' ',$83,'#','@',$85,'#'
        .byte ' ',$82,'#',$82,' ','#',$83,' ','#',' ',$82,'#'
        .byte $82,' ','#',$83,' ','$','.',$82,'#',$82,' ',$82
        .byte '#','$',$82,'#','.',$83,'#','$',$82,'#',$82,' '
        .byte '#','.',$82,'#',$83,' ','$',$82,' ','#','.',$82
        .byte '#',$83,' ','#',$82,' ',$8B,'#',$82,' '

; level64  9x10  raw=90B  rle=61B  (save 29B)
level64:
        .byte 9,10,1,5
        .byte $88,'#',' ','#',$86,' ','#',' ','#',' ',$84,'#'
        .byte ' ','#',' ','#',' ','#',$83,'.','@','#',' ','#'
        .byte ' ',$83,'#','$',$84,'#',' ','#',$85,' ',$82,'#'
        .byte $82,' ',$82,'$',' ','$',' ',$85,'#',$83,' ',$82
        .byte '#',$83,' ','#','.',$83,'#',$84,' ',$83,'#',$83
        .byte ' '

; level65  13x6  raw=78B  rle=39B  (save 39B)
level65:
        .byte 13,6,3,3
        .byte $83,' ',$8E,'#',$84,' ',$82,'#',$82,' ',$82,'#'
        .byte $82,' ',$83,'$',$84,'.','$','@',$82,'#',$86,' '
        .byte $83,'#',$82,' ',$82,'#',$83,' ',$84,'#',' ',$89
        .byte '#',$88,' '

; level66  19x6  raw=114B  rle=66B  (save 48B)
level66:
        .byte 19,6,3,0
        .byte $85,'#',$83,' ',$84,'#',$87,' ','#',$83,' ',$85
        .byte '#',' ','.','#',$87,' ','#',$87,' ','$',$82,' '
        .byte $8B,'#',$82,' ',$84,'#',' ','.','$',$84,' ','@'
        .byte ' ','#',$82,' ','#',$82,' ','#',$82,' ','#',$82
        .byte ' ',$84,'#',$83,' ','#',$82,' ',$84,'#',$82,' '
        .byte $84,'#',$82,' ',$85,'#'

; level67  10x9  raw=90B  rle=67B  (save 23B)
level67:
        .byte 10,9,1,5
        .byte ' ',$86,'#',$83,' ',$82,'#',$84,' ','#',$83,' '
        .byte '#',$83,' ','$',' ','#',$83,' ','#',$82,' ',$82
        .byte '$',' ','#',$83,' ',$83,'#',' ','.',$85,'#',$82
        .byte ' ',$82,'#','.','#',' ','@',' ','#',$83,' ','#'
        .byte '.',$82,' ','$',' ','#',$83,' ','#','.',' ',$84
        .byte '#',$83,' ',$84,'#',$83,' '

; level68  9x9  raw=81B  rle=57B  (save 24B)
level68:
        .byte 9,9,1,5
        .byte $82,' ',$86,'#',$83,' ','#',$84,' ','#',$83,' '
        .byte '#',$82,' ','$',' ','#',$82,' ',$84,'#','$',' '
        .byte '#',' ',$82,'#',' ','$',' ','$',' ','#',' ','#'
        .byte $84,'.','#',' ',$83,'#',$85,' ','@',' ',$83,'#'
        .byte $82,' ','#',$83,' ','#',' ',$88,'#'

; level69  7x8  raw=56B  rle=46B  (save 10B)
level69:
        .byte 7,8,2,6
        .byte $85,'#',$82,' ','#',$83,' ',$82,'#',' ','#',' '
        .byte '#',$82,' ','#',' ','#','@','$','*','.',$84,'#'
        .byte $82,' ','.',' ','#',' ','#',' ','$','#',' ','#'
        .byte ' ',$82,'#',$83,' ','#',$82,' ',$85,'#'

; level70  10x7  raw=70B  rle=43B  (save 27B)
level70:
        .byte 10,7,2,5
        .byte ' ',$84,'#',$86,' ','#',$82,' ',$88,'#',$84,' '
        .byte '$',$82,' ',$82,'#',' ','.','#',' ','$',$83,' '
        .byte $82,'#',' ','.','#','$',$86,'#',' ','.','@',' '
        .byte '#',$84,' ',$86,'#',$84,' '

; level71  11x8  raw=88B  rle=67B  (save 21B)
level71:
        .byte 11,8,2,4
        .byte $84,'#',$82,' ',$84,'#',' ','#',$82,' ',$84,'#'
        .byte $82,' ','#',' ','#',$82,' ','#',$82,' ','#',$82
        .byte ' ','#',' ','#',$82,' ','#',$84,' ','$',$83,'#'
        .byte $82,' ','.',' ','.','#','$',$82,' ',$82,'#','@'
        .byte ' ',$82,'#',' ','#',' ','$',' ',$82,'#',$83,' '
        .byte '.',' ','#',$83,' ',$8C,'#'

; level72  8x10  raw=80B  rle=59B  (save 21B)
level72:
        .byte 8,10,1,6
        .byte $85,'#',$83,' ','#',' ','@',' ',$85,'#',$86,' '
        .byte $82,'#',' ','$',' ',$82,'$',' ',$83,'#','$',$82
        .byte '#',$82,' ',$82,'#',$83,' ',$85,'#',' ',$82,'.'
        .byte $82,' ','#',' ',$82,'#',$82,'.',$82,' ','#',$82
        .byte ' ',$83,'#',$82,' ','#',$84,' ',$84,'#',' '
