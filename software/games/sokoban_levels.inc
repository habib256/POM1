; =============================================
; sokoban_levels.inc - RLE-compressed levels 1..45
; Auto-generated by tools/sokoban_rle.py. Do not edit.
; Format: header (w, h, row_offset, col_offset) + RLE byte stream.
; RLE: byte<$80 = literal; byte>=$80 -> (byte & $7F) copies of next byte.
; Shared by text + TMS variants; HGR also pulls sokoban_levels_ext.inc.
; =============================================

; level1  5x3  raw=15B  rle=7B  (save 8B)
level1:
        .byte 5,3,4,7
        .byte $86,'#','.','$','@',$86,'#'

; level2  7x6  raw=42B  rle=25B  (save 17B)
level2:
        .byte 7,6,3,6
        .byte $88,'#','.',$84,' ',$82,'#',$82,' ','$',$82,' '
        .byte $82,'#',$85,' ',$82,'#',$82,' ','@',$82,' ',$88
        .byte '#'

; level3  9x7  raw=63B  rle=31B  (save 32B)
level3:
        .byte 9,7,2,5
        .byte $8A,'#','.',$85,' ','.',$82,'#',$87,' ',$82,'#'
        .byte ' ','$',$83,' ','$',' ',$82,'#',$87,' ',$82,'#'
        .byte $83,' ','@',$83,' ',$8A,'#'

; level4  6x7  raw=42B  rle=33B  (save 9B)
level4:
        .byte 6,7,2,7
        .byte $84,'#',$82,' ','#',' ','.','#',$82,' ','#',$82
        .byte ' ',$84,'#','*','@',$82,' ',$82,'#',$82,' ','$'
        .byte ' ',$82,'#',$82,' ',$87,'#',$82,' '

; level5  6x7  raw=42B  rle=28B  (save 14B)
level5:
        .byte 6,7,2,7
        .byte $87,'#',$84,' ',$82,'#',' ','#','@',' ',$82,'#'
        .byte ' ','$','*',' ',$82,'#',' ','.','*',' ',$82,'#'
        .byte $84,' ',$87,'#'

; level6  9x6  raw=54B  rle=36B  (save 18B)
level6:
        .byte 9,6,3,5
        .byte $82,' ',$84,'#',$83,' ',$83,'#',$82,' ',$85,'#'
        .byte $85,' ','$',' ',$82,'#',' ','#',$82,' ','#','$'
        .byte ' ',$82,'#',' ','.',' ','.','#','@',' ',$8A,'#'

; level7  8x6  raw=48B  rle=25B  (save 23B)
level7:
        .byte 8,6,3,6
        .byte $89,'#',$86,' ',$82,'#',' ','.',$82,'*','$','@'
        .byte $82,'#',$86,' ',$86,'#',$82,' ','#',$84,' ',$84
        .byte '#'

; level8  8x7  raw=56B  rle=36B  (save 20B)
level8:
        .byte 8,7,2,6
        .byte ' ',$87,'#',' ','#',$85,' ','#',' ','#',' ','.'
        .byte '$','.',' ',$83,'#',' ','$','@','$',' ',$82,'#'
        .byte $82,' ','.','$','.',' ',$82,'#',$86,' ',$89,'#'

; level9  12x6  raw=72B  rle=38B  (save 34B)
level9:
        .byte 12,6,3,4
        .byte $86,'#',' ',$86,'#',$84,' ',$83,'#',$83,' ',$82
        .byte '#',' ',$82,'$',$85,' ','#','@',$82,'#',' ','$'
        .byte ' ','#',$83,'.',$83,' ',$82,'#',$83,' ',$8D,'#'
        .byte $87,' '

; level10  7x8  raw=56B  rle=41B  (save 15B)
level10:
        .byte 7,8,2,6
        .byte $88,'#',$85,' ',$82,'#',' ','.','$','.',' ',$82
        .byte '#',' ','$','.','$',' ',$82,'#',' ','.','$','.'
        .byte ' ',$82,'#',' ','$','.','$',' ',$82,'#',$82,' '
        .byte '@',$82,' ',$88,'#'

; level11  8x12  raw=96B  rle=75B  (save 21B)
level11:
        .byte 8,12,0,6
        .byte $82,' ',$86,'#',$82,' ','#',' ',$82,'.','@','#'
        .byte $82,' ','#',' ',$82,'$',' ','#',$82,' ',$82,'#'
        .byte ' ',$83,'#',$83,' ','#',' ','#',$85,' ','#',' '
        .byte '#',$82,' ',$84,'#',' ','#',$82,' ','#',$84,' '
        .byte $82,'#',' ','#',' ','#',$83,' ','#',' ','#',$83
        .byte ' ','#',' ','#',' ',$83,'#',$83,' ','#',$83,' '
        .byte $85,'#',' '

; level12  6x7  raw=42B  rle=34B  (save 8B)
level12:
        .byte 6,7,2,7
        .byte $85,'#',' ','#','.',$82,' ',$83,'#','@',$82,'$'
        .byte ' ',$83,'#',$83,' ','#',' ',$82,'#',$82,' ','#'
        .byte $82,' ',$82,'#','.','#',$83,' ',$83,'#'

; level13  11x8  raw=88B  rle=53B  (save 35B)
level13:
        .byte 11,8,2,4
        .byte $86,' ',$85,'#',$86,' ','#','.',$82,' ','#',$86
        .byte ' ','#','.','#',' ',$88,'#','.','#',' ',$82,'#'
        .byte ' ','@',' ','$',' ','$',' ','$',' ',$82,'#',' '
        .byte '#',' ','#',' ','#',' ',$84,'#',$87,' ','#',$82
        .byte ' ',$89,'#',$82,' '

; level14  9x8  raw=72B  rle=45B  (save 27B)
level14:
        .byte 9,8,2,5
        .byte $82,' ',$86,'#',$83,' ','#',$84,' ','#',$83,' '
        .byte '#',' ',$82,'#','@',$85,'#',' ','#',' ','$',' '
        .byte $82,'#',' ',$82,'.','#',' ','$',' ',$82,'#',$87
        .byte ' ',$82,'#',$82,' ',$8A,'#',$85,' '

; level15  9x8  raw=72B  rle=53B  (save 19B)
level15:
        .byte 9,8,2,5
        .byte $85,'#',$84,' ','#',$83,' ',$82,'#',$83,' ','#'
        .byte ' ','$',$82,' ','#',$83,' ',$82,'#',' ','$',' '
        .byte $84,'#',' ',$83,'#','@','.',$82,' ','#',$82,' '
        .byte '#',$82,' ','.','#',' ','#',$82,' ','#',$85,' '
        .byte '#',$82,' ',$87,'#'

; level16  7x9  raw=63B  rle=54B  (save 9B)
level16:
        .byte 7,9,1,6
        .byte $84,'#',$83,' ','#','.',' ',$82,'#',$82,' ','#'
        .byte '.','@',' ','#',$82,' ','#','.',' ','$','#',$82
        .byte ' ',$82,'#','$',' ',$83,'#',' ','#',' ','$',$82
        .byte ' ','#',' ','#',$84,' ','#',' ','#',$82,' ',$83
        .byte '#',' ',$84,'#',$82,' '

; level17  7x6  raw=42B  rle=26B  (save 16B)
level17:
        .byte 7,6,3,6
        .byte $88,'#',$85,' ',$82,'#',' ','#',' ','#',' ',$82
        .byte '#','.',' ','$','*','@',$82,'#',$83,' ',$88,'#'
        .byte $82,' '

; level18  9x7  raw=63B  rle=38B  (save 25B)
level18:
        .byte 9,7,2,5
        .byte $85,' ',$83,'#',' ',$86,'#','@',$83,'#',$84,' '
        .byte '.','*',' ',$82,'#',$83,' ','#',$83,' ',$86,'#'
        .byte '$','#',' ','#',$84,' ','#',$83,' ','#',$84,' '
        .byte $85,'#'

; level19  10x8  raw=80B  rle=54B  (save 26B)
level19:
        .byte 10,8,2,5
        .byte ' ',$84,'#',$86,' ','#',$82,' ',$84,'#',$83,' '
        .byte '#',$85,' ',$82,'#',' ',$82,'#',' ',$82,'#',$83
        .byte ' ','#',' ','#','.',' ','.','#',' ','@','$',$83
        .byte '#',$83,' ','#',' ',$82,'$',' ',$82,'#',$82,' '
        .byte '.','#',$84,' ',$8B,'#'

; level20  6x7  raw=42B  rle=27B  (save 15B)
level20:
        .byte 6,7,2,7
        .byte $85,'#',' ','#',' ','@',' ','#',' ','#',$83,'.'
        .byte '#',' ','#',$83,'$',$83,'#',$84,' ',$82,'#',$84
        .byte ' ',$87,'#'

; level21  7x9  raw=63B  rle=47B  (save 16B)
level21:
        .byte 7,9,1,6
        .byte $88,'#',$85,' ',$82,'#','.',' ','.',$82,' ',$82
        .byte '#',' ',$82,'#',' ',$83,'#',$82,' ','$',' ','#'
        .byte ' ',$83,'#','$',' ','#',$83,' ','#','@',' ','#'
        .byte $83,' ','#',$82,' ','#',$83,' ',$84,'#',' '

; level22  8x8  raw=64B  rle=43B  (save 21B)
level22:
        .byte 8,8,2,6
        .byte $89,'#',$83,' ',$82,'.',' ',$82,'#',$82,' ','@'
        .byte $82,'$',' ',$86,'#',' ',$82,'#',$83,' ','#',$82
        .byte ' ','#',$84,' ','#',$82,' ','#',$84,' ','#',$82
        .byte ' ','#',$84,' ',$84,'#',' '

; level23  9x8  raw=72B  rle=48B  (save 24B)
level23:
        .byte 9,8,2,5
        .byte $87,'#',$82,' ','#',$85,' ',$84,'#',$82,' ','@'
        .byte $82,'$',$82,'.',$85,'#',' ',$82,'#',' ','#',$82
        .byte ' ','#',$85,' ','#',$82,' ','#',$82,' ',$84,'#'
        .byte $82,' ','#',$82,' ','#',$85,' ',$84,'#',$83,' '

; level24  7x6  raw=42B  rle=29B  (save 13B)
level24:
        .byte 7,6,3,6
        .byte $84,'#',$83,' ','#',$82,' ',$85,'#',' ','.',' '
        .byte '.',' ',$82,'#',' ',$82,'$','#','@',$83,'#',$84
        .byte ' ','#',' ',$86,'#'

; level25  7x9  raw=63B  rle=50B  (save 13B)
level25:
        .byte 7,9,1,6
        .byte $85,'#',$82,' ','#',$83,' ',$84,'#','.',' ','.'
        .byte $82,' ',$82,'#',$83,' ','#',' ',$83,'#',' ','#'
        .byte $82,' ','#',' ','#','@',$82,'$',' ','#',' ','#'
        .byte $84,' ','#',' ','#',$82,' ',$83,'#',' ',$84,'#'
        .byte $82,' '

; level26  7x7  raw=49B  rle=35B  (save 14B)
level26:
        .byte 7,7,2,6
        .byte $88,'#',$82,' ','*',$82,' ',$82,'#',$85,' ',$83
        .byte '#',' ','#',' ',$82,'#',' ','#','$','@','.','#'
        .byte $82,' ','#',$83,' ','#',$82,' ',$85,'#',' '

; level27  7x7  raw=49B  rle=31B  (save 18B)
level27:
        .byte 7,7,2,6
        .byte '#',' ',$85,'#',$82,' ','#',$83,' ',$84,'#',$82
        .byte '$','@',$82,'#',$83,' ',$84,'#',$85,' ',$82,'#'
        .byte ' ','.',' ','.',' ',$88,'#'

; level28  7x7  raw=49B  rle=36B  (save 13B)
level28:
        .byte 7,7,2,6
        .byte ' ',$84,'#',$83,' ','#',$82,' ',$83,'#',' ','#'
        .byte ' ',$82,'$',' ',$83,'#',$83,'.',' ',$82,'#',$82
        .byte ' ','@','$',' ',$82,'#',$83,' ',$88,'#',$82,' '

; level29  6x8  raw=48B  rle=37B  (save 11B)
level29:
        .byte 6,8,2,7
        .byte ' ',$85,'#',' ','#',' ','@',' ','#',' ','#',$83
        .byte ' ',$84,'#','$',' ',$82,'#',' ',$83,'.',$82,'#'
        .byte ' ',$82,'$',' ',$84,'#',$82,' ','#',$82,' ',$84
        .byte '#'

; level30  7x7  raw=49B  rle=36B  (save 13B)
level30:
        .byte 7,7,2,6
        .byte $86,'#',' ','#',$83,' ','.','#',' ','#',' ',$82
        .byte '#',' ',$83,'#',$82,' ',$82,'$','@',$82,'#',' '
        .byte '#',$83,' ',$82,'#','.',$82,' ',$88,'#',$82,' '

; level31  7x7  raw=49B  rle=36B  (save 13B)
level31:
        .byte 7,7,2,6
        .byte $85,'#',$82,' ','#',$83,' ','#',$82,' ','#',' '
        .byte '@',' ','#',$82,' ','#',' ',$82,'$',$85,'#','.'
        .byte ' ','.',' ','#',' ','#',$84,' ','#',' ',$86,'#'

; level32  11x9  raw=99B  rle=55B  (save 44B)
level32:
        .byte 11,9,1,4
        .byte $85,' ',$85,'#',$86,' ','#',$83,' ',$82,'#',$85
        .byte ' ','#',$84,' ','#',' ',$86,'#',$83,' ',$83,'#'
        .byte $85,' ','#','.',' ',$82,'#',' ','$',' ','$',' '
        .byte '@',$82,' ',$83,'#',' ',$86,'#','.','#',' ','#'
        .byte $88,' ','#',' ',$8A,'#',' '

; level33  6x7  raw=42B  rle=31B  (save 11B)
level33:
        .byte 6,7,2,7
        .byte $84,'#',$82,' ','#',$82,' ',$84,'#',' ',$82,'$'
        .byte ' ',$82,'#',$83,'.',' ',$82,'#',' ','@','$',' '
        .byte $82,'#',$83,' ',$87,'#',' '

; level34  7x7  raw=49B  rle=40B  (save 9B)
level34:
        .byte 7,7,2,6
        .byte $82,' ',$84,'#',$82,' ',$82,'#',$82,' ','#',' '
        .byte $82,'#','@','$','.',$83,'#',' ',$82,'$',$82,' '
        .byte $82,'#',' ','.',' ','.',' ',$84,'#',$83,' ','#'
        .byte $82,' ',$85,'#'

; level35  7x7  raw=49B  rle=35B  (save 14B)
level35:
        .byte 7,7,2,6
        .byte ' ',$84,'#',$82,' ',$82,'#',$82,' ',$84,'#',$85
        .byte ' ',$82,'#','.',$82,'*','$','@',$82,'#',$83,' '
        .byte $85,'#',$82,' ','#',$83,' ',$84,'#',$82,' '

; level36  7x7  raw=49B  rle=37B  (save 12B)
level36:
        .byte 7,7,2,6
        .byte $88,'#','.',' ','#',$82,' ',$82,'#',$82,' ','$'
        .byte $82,' ',$82,'#','.',' ','$','#','@',$82,'#',$82
        .byte ' ','$',$82,' ',$82,'#','.',' ','#',$82,' ',$88
        .byte '#'

; level37  9x6  raw=54B  rle=28B  (save 26B)
level37:
        .byte 9,6,3,5
        .byte $82,' ',$84,'#',$83,' ',$83,'#',$82,' ',$85,'#'
        .byte $87,' ',$82,'#','@','$',$83,'*','.',' ',$82,'#'
        .byte $87,' ',$8A,'#'

; level38  6x10  raw=60B  rle=51B  (save 9B)
level38:
        .byte 6,10,1,7
        .byte ' ',$84,'#',' ',$82,'#',$82,' ','#',' ','#','.'
        .byte ' ','$','#',' ','#','.','$',' ','#',' ','#','.'
        .byte '$',' ','#',' ','#','.','$',' ','#',' ','#','.'
        .byte ' ','$',$83,'#',$83,' ','@',$83,'#',$83,' ','#'
        .byte ' ',$85,'#'

; level39  15x5  raw=75B  rle=31B  (save 44B)
level39:
        .byte 15,5,3,2
        .byte $84,'#',$8B,' ','#',$82,' ',$8D,'#',' ','$',' '
        .byte '$',' ','$',' ','$',' ','$',' ','@',' ',$82,'#'
        .byte ' ',$85,'.',$87,' ',$90,'#'

; level40  9x8  raw=72B  rle=47B  (save 25B)
level40:
        .byte 9,8,2,5
        .byte $86,' ',$88,'#',' ','#','.',$82,'#',$83,' ',$83
        .byte '#','.',$82,'#',$83,' ','$',' ','#','.',$82,'#'
        .byte ' ','$',$82,' ','$',$82,' ',$86,'#','@','#',' '
        .byte '#',$84,' ','#',$83,' ','#',$84,' ',$85,'#'

; level41  10x7  raw=70B  rle=42B  (save 28B)
level41:
        .byte 10,7,2,5
        .byte $8B,'#',$88,' ',$82,'#',' ',$82,'#','.',$83,'#'
        .byte ' ',$82,'#',' ','#',' ',$82,'$',' ','.',' ',$82
        .byte '#',' ','.',' ','@','$',$82,'#',' ',$86,'#',$84
        .byte ' ','#',$84,' ',$86,'#'

; level42  10x9  raw=90B  rle=58B  (save 32B)
level42:
        .byte 10,9,1,5
        .byte $85,'#',$85,' ','#',$83,' ',$84,'#',$82,' ','#'
        .byte ' ','#',' ','#',' ','.','#',$82,' ','#',$84,' '
        .byte '$',' ',$86,'#',' ','#','$','.',$82,' ',$82,'#'
        .byte $83,' ','#','@',$83,' ',$82,'#',' ','#',' ',$87
        .byte '#',$83,' ','#',$85,' ',$85,'#',$85,' '

; level43  7x6  raw=42B  rle=29B  (save 13B)
level43:
        .byte 7,6,3,6
        .byte ' ',$85,'#',$82,' ','#',$83,' ','#',' ',$82,'#'
        .byte $83,' ',$83,'#',' ',$83,'$',' ',$82,'#',' ','.'
        .byte '+','.',' ',$88,'#'

; level44  8x6  raw=48B  rle=30B  (save 18B)
level44:
        .byte 8,6,3,6
        .byte $87,'#',' ','#',$85,' ','#',' ','#','@',$83,'$'
        .byte ' ',$83,'#',$82,' ','#',$83,'.',$83,'#',$84,' '
        .byte $82,'#',' ',$86,'#',' '

; level45  7x8  raw=56B  rle=39B  (save 17B)
level45:
        .byte 7,8,2,6
        .byte $83,' ',$84,'#',$83,' ','#',$82,' ','#',$83,' '
        .byte '#','@',' ',$85,'#','$','.',$82,'#',$83,' ','$'
        .byte '.',$82,'#',' ','#',' ','$','.',$82,'#',$84,' '
        .byte $88,'#',' '
